## modules/hal_silabs/simplicity_sdk/zigbee/generated/Kconfig.components
```kconfig
# Copyright (c) 2026 Silicon Laboratories Inc.
# SPDX-License-Identifier: Apache-2.0

# Generated by scripts/gen_zigbee_components.py

menu "Zigbee component sources"
	depends on SILABS_SISDK_ZIGBEE

config SILABS_SISDK_ZIGBEE_BYTE_UTILITIES
	bool "Byte Utilities"
	depends on SILABS_SISDK_ZIGBEE
	help
	  Generated from byte_utilities.slcc. Category: Platform|Utilities.

config SILABS_SISDK_ZIGBEE_APPLICATION_BOOTLOADER
	bool "Zigbee Application Bootloader"
	depends on SILABS_SISDK_ZIGBEE
	help
	  Generated from zigbee_application_bootloader.slcc. Category:
	  Zigbee|Bootloader.

config SILABS_SISDK_ZIGBEE_BASIC
	bool "Basic Server Cluster"
	depends on SILABS_SISDK_ZIGBEE
	help
	  Generated from zigbee_basic.slcc. Category: Zigbee|Cluster
	  Library|Common.

config SILABS_SISDK_ZIGBEE_CLI
	bool "Zigbee CLI"
	depends on SILABS_SISDK_ZIGBEE
	help
	  Generated from zigbee_cli.slcc. Category: Zigbee|Utility.

config SILABS_SISDK_ZIGBEE_CLUSTER_SERVICE
	bool "Zigbee Cluster Service"
	depends on SILABS_SISDK_ZIGBEE
	help
	  Generated from zigbee_cluster_service.slcc. Category: Zigbee|Utility.

config SILABS_SISDK_ZIGBEE_COLOR_CONTROL_SERVER
	bool "Color Control Cluster Server"
	depends on SILABS_SISDK_ZIGBEE
	help
	  Generated from zigbee_color_control_server.slcc. Category:
	  Zigbee|Cluster Library|Home Automation.

config SILABS_SISDK_ZIGBEE_CORE_CLI
	bool "Zigbee Core CLI"
	depends on SILABS_SISDK_ZIGBEE
	depends on SILABS_SISDK_ZIGBEE_CLI
	help
	  Generated from zigbee_core_cli.slcc. Category: Zigbee|Utility. Acyclic
	  component requirements: SILABS_SISDK_ZIGBEE_CLI.

config SILABS_SISDK_ZIGBEE_COUNTERS
	bool "Counters"
	depends on SILABS_SISDK_ZIGBEE
	help
	  Generated from zigbee_counters.slcc. Category: Zigbee|Utility.

config SILABS_SISDK_ZIGBEE_DEBUG_BASIC_COMPONENT
	bool "Debug Basic"
	depends on SILABS_SISDK_ZIGBEE
	depends on SILABS_SISDK_ZIGBEE_DEBUG_BASIC
	imply SILABS_SISDK_ZIGBEE_DEBUG_BASIC_LIBRARY
	help
	  Generated from zigbee_debug_basic.slcc. Category: Zigbee|Stack. Cyclic
	  component relationships represented as soft implies:
	  SILABS_SISDK_ZIGBEE_DEBUG_BASIC_LIBRARY.

config SILABS_SISDK_ZIGBEE_DEBUG_BASIC_LIBRARY
	bool "Debug Basic (Library)"
	depends on SILABS_SISDK_ZIGBEE
	help
	  Generated from zigbee_debug_basic_library.slcc. Category:
	  Zigbee|Stack.

config SILABS_SISDK_ZIGBEE_DEBUG_PRINT
	bool "Debug Print"
	depends on SILABS_SISDK_ZIGBEE
	help
	  Generated from zigbee_debug_print.slcc. Category: Zigbee|Utility.

config SILABS_SISDK_ZIGBEE_DEVICE_CONFIG
	bool "Zigbee Device Config"
	depends on SILABS_SISDK_ZIGBEE
	help
	  Generated from zigbee_device_config.slcc. Category: Zigbee|Utility.

config SILABS_SISDK_ZIGBEE_ENHANCED_ROUTING
	bool "Zigbee Enhanced Routing With LQI"
	depends on SILABS_SISDK_ZIGBEE
	help
	  Generated from zigbee_enhanced_routing.slcc. Category: Zigbee|Utility.

config SILABS_SISDK_ZIGBEE_FIND_AND_BIND_TARGET
	bool "Find and Bind Target"
	depends on SILABS_SISDK_ZIGBEE
	help
	  Generated from zigbee_find_and_bind_target.slcc. Category:
	  Zigbee|Zigbee 3.0.

config SILABS_SISDK_ZIGBEE_GP
	bool "Green Power"
	depends on SILABS_SISDK_ZIGBEE
	depends on SILABS_SISDK_ZIGBEE_GREEN_POWER
	imply SILABS_SISDK_ZIGBEE_GP_LIBRARY
	help
	  Generated from zigbee_gp.slcc. Category: Zigbee|Stack. Cyclic
	  component relationships represented as soft implies:
	  SILABS_SISDK_ZIGBEE_GP_LIBRARY.

config SILABS_SISDK_ZIGBEE_GP_LIBRARY
	bool "Green Power (Library)"
	depends on SILABS_SISDK_ZIGBEE
	help
	  Generated from zigbee_gp_library.slcc. Category: Zigbee|Stack.

config SILABS_SISDK_ZIGBEE_GREEN_POWER_CLIENT
	bool "Green Power Client"
	depends on SILABS_SISDK_ZIGBEE
	depends on SILABS_SISDK_ZIGBEE_GP
	depends on SILABS_SISDK_ZIGBEE_GREEN_POWER_COMMON
	help
	  Generated from zigbee_green_power_client.slcc. Category: Zigbee|Green
	  Power. Acyclic component requirements: SILABS_SISDK_ZIGBEE_GP,
	  SILABS_SISDK_ZIGBEE_GREEN_POWER_COMMON.

config SILABS_SISDK_ZIGBEE_GREEN_POWER_CLIENT_CLI
	bool "Green Power Client CLI"
	depends on SILABS_SISDK_ZIGBEE
	help
	  Generated from zigbee_green_power_client_cli.slcc. Category:
	  Zigbee|Green Power.

config SILABS_SISDK_ZIGBEE_GREEN_POWER_COMMON
	bool "Green Power Common"
	depends on SILABS_SISDK_ZIGBEE
	depends on SILABS_SISDK_ZIGBEE_GP
	help
	  Generated from zigbee_green_power_common.slcc. Category: Zigbee|Green
	  Power. Acyclic component requirements: SILABS_SISDK_ZIGBEE_GP.

config SILABS_SISDK_ZIGBEE_GROUPS_SERVER
	bool "Groups Server Cluster"
	depends on SILABS_SISDK_ZIGBEE
	help
	  Generated from zigbee_groups_server.slcc. Category: Zigbee|Cluster
	  Library|Common.

config SILABS_SISDK_ZIGBEE_IDENTIFY
	bool "Identify Cluster"
	depends on SILABS_SISDK_ZIGBEE
	help
	  Generated from zigbee_identify.slcc. Category: Zigbee|Cluster
	  Library|Common.

config SILABS_SISDK_ZIGBEE_INTERPAN
	bool "Interpan"
	depends on SILABS_SISDK_ZIGBEE
	help
	  Generated from zigbee_interpan.slcc. Category: Zigbee|Utility.

config SILABS_SISDK_ZIGBEE_LEVEL_CONTROL
	bool "Level Control Server Cluster"
	depends on SILABS_SISDK_ZIGBEE
	help
	  Generated from zigbee_level_control.slcc. Category: Zigbee|Cluster
	  Library|Common.

config SILABS_SISDK_ZIGBEE_NETWORK_CREATOR
	bool "Network Creator"
	depends on SILABS_SISDK_ZIGBEE
	depends on SILABS_SISDK_ZIGBEE_SCAN_DISPATCH
	depends on SILABS_SISDK_ZIGBEE_NETWORK_CREATOR_SECURITY
	help
	  Generated from zigbee_network_creator.slcc. Category: Zigbee|Zigbee
	  3.0. Acyclic component requirements:
	  SILABS_SISDK_ZIGBEE_SCAN_DISPATCH,
	  SILABS_SISDK_ZIGBEE_NETWORK_CREATOR_SECURITY.

config SILABS_SISDK_ZIGBEE_NETWORK_CREATOR_SECURITY
	bool "Network Creator Security"
	depends on SILABS_SISDK_ZIGBEE
	help
	  Generated from zigbee_network_creator_security.slcc. Category:
	  Zigbee|Zigbee 3.0.

config SILABS_SISDK_ZIGBEE_NETWORK_STEERING
	bool "Network Steering"
	depends on SILABS_SISDK_ZIGBEE
	depends on SILABS_SISDK_ZIGBEE_SCAN_DISPATCH
	imply SILABS_SISDK_ZIGBEE_UPDATE_TC_LINK_KEY
	help
	  Generated from zigbee_network_steering.slcc. Category: Zigbee|Zigbee
	  3.0. Acyclic component requirements:
	  SILABS_SISDK_ZIGBEE_SCAN_DISPATCH. Cyclic component relationships
	  represented as soft implies: SILABS_SISDK_ZIGBEE_UPDATE_TC_LINK_KEY.

config SILABS_SISDK_ZIGBEE_ON_OFF
	bool "On/Off Server Cluster"
	depends on SILABS_SISDK_ZIGBEE
	help
	  Generated from zigbee_on_off.slcc. Category: Zigbee|Cluster
	  Library|Home Automation.

config SILABS_SISDK_ZIGBEE_PHY_2_4
	bool "Zigbee 2.4GHz Device"
	depends on SILABS_SISDK_ZIGBEE
	help
	  Generated from zigbee_phy_2_4.slcc. Category: Zigbee|Stack|PHY
	  support.

config SILABS_SISDK_ZIGBEE_PRO_STACK
	bool "Pro Stack (Common)"
	depends on SILABS_SISDK_ZIGBEE
	depends on SILABS_SISDK_ZIGBEE_STACK_PRO
	imply SILABS_SISDK_ZIGBEE_PRO_STACK_BASIC
	help
	  Generated from zigbee_pro_stack.slcc. Category: Zigbee|Stack|Pro Core.
	  Cyclic component relationships represented as soft implies:
	  SILABS_SISDK_ZIGBEE_PRO_STACK_BASIC.

config SILABS_SISDK_ZIGBEE_PRO_STACK_BASIC
	bool "Pro Stack (Basic)"
	depends on SILABS_SISDK_ZIGBEE
	imply SILABS_SISDK_ZIGBEE_PRO_STACK_LIBRARY
	imply SILABS_SISDK_ZIGBEE_STACK_COMMON
	help
	  Generated from zigbee_pro_stack_basic.slcc. Category: Zigbee|Stack|Pro
	  Core. Cyclic component relationships represented as soft implies:
	  SILABS_SISDK_ZIGBEE_PRO_STACK_LIBRARY,
	  SILABS_SISDK_ZIGBEE_STACK_COMMON.

config SILABS_SISDK_ZIGBEE_PRO_STACK_LIBRARY
	bool "Zigbee PRO Stack (Library)"
	depends on SILABS_SISDK_ZIGBEE
	help
	  Generated from zigbee_pro_stack_library.slcc. Category: Zigbee|Stack.

config SILABS_SISDK_ZIGBEE_REPORTING
	bool "Reporting"
	depends on SILABS_SISDK_ZIGBEE
	help
	  Generated from zigbee_reporting.slcc. Category: Zigbee|Cluster
	  Library|Common.

config SILABS_SISDK_ZIGBEE_SCAN_DISPATCH
	bool "Scan Dispatch"
	depends on SILABS_SISDK_ZIGBEE
	help
	  Generated from zigbee_scan_dispatch.slcc. Category: Zigbee|Network
	  Form and Join.

config SILABS_SISDK_ZIGBEE_SCENES
	bool "Scenes Server Cluster"
	depends on SILABS_SISDK_ZIGBEE
	help
	  Generated from zigbee_scenes.slcc. Category: Zigbee|Cluster
	  Library|Common.

config SILABS_SISDK_ZIGBEE_SECURE_KEY_STORAGE
	bool "Zigbee Secure Key Storage"
	depends on SILABS_SISDK_ZIGBEE
	imply SILABS_SISDK_ZIGBEE_SECURE_KEY_STORAGE_UPGRADE
	help
	  Generated from zigbee_secure_key_storage.slcc. Category:
	  Zigbee|Utility. Cyclic component relationships represented as soft
	  implies: SILABS_SISDK_ZIGBEE_SECURE_KEY_STORAGE_UPGRADE.

config SILABS_SISDK_ZIGBEE_SECURE_KEY_STORAGE_UPGRADE
	bool "Zigbee Secure Key Storage Upgrade"
	depends on SILABS_SISDK_ZIGBEE
	help
	  Generated from zigbee_secure_key_storage_upgrade.slcc. Category:
	  Zigbee|Utility.

config SILABS_SISDK_ZIGBEE_SECURITY_MANAGER
	bool "Zigbee Security Manager"
	depends on SILABS_SISDK_ZIGBEE
	depends on SILABS_SISDK_ZIGBEE_SECURE_KEY_STORAGE
	help
	  Generated from zigbee_security_manager.slcc. Category: Zigbee|Utility.
	  Acyclic component requirements:
	  SILABS_SISDK_ZIGBEE_SECURE_KEY_STORAGE.

config SILABS_SISDK_ZIGBEE_SIGNATURE_DECODE
	bool "Zigbee Signature Decode"
	depends on SILABS_SISDK_ZIGBEE
	help
	  Generated from zigbee_signature_decode.slcc. Category: Zigbee|Utility.

config SILABS_SISDK_ZIGBEE_SOURCE_ROUTE_COMPONENT
	bool "Source route"
	depends on SILABS_SISDK_ZIGBEE
	depends on SILABS_SISDK_ZIGBEE_SOURCE_ROUTE
	imply SILABS_SISDK_ZIGBEE_SOURCE_ROUTE_LIBRARY
	help
	  Generated from zigbee_source_route.slcc. Category: Zigbee|Stack.
	  Cyclic component relationships represented as soft implies:
	  SILABS_SISDK_ZIGBEE_SOURCE_ROUTE_LIBRARY.

config SILABS_SISDK_ZIGBEE_SOURCE_ROUTE_LIBRARY
	bool "Source Routing (Library)"
	depends on SILABS_SISDK_ZIGBEE
	help
	  Generated from zigbee_source_route_library.slcc. Category:
	  Zigbee|Stack.

config SILABS_SISDK_ZIGBEE_STACK_COMMON
	bool "Stack Common"
	depends on SILABS_SISDK_ZIGBEE
	depends on SILABS_SISDK_ZIGBEE_STRONG_RANDOM_API_PSA
	depends on SILABS_SISDK_ZIGBEE_SECURITY_MANAGER
	depends on SILABS_SISDK_ZIGBEE_BYTE_UTILITIES
	imply SILABS_SISDK_ZIGBEE_SYSTEM_COMMON
	help
	  Generated from zigbee_stack_common.slcc. Category: Zigbee|Stack|Pro
	  Core. Acyclic component requirements:
	  SILABS_SISDK_ZIGBEE_STRONG_RANDOM_API_PSA,
	  SILABS_SISDK_ZIGBEE_SECURITY_MANAGER,
	  SILABS_SISDK_ZIGBEE_BYTE_UTILITIES. Cyclic component relationships
	  represented as soft implies: SILABS_SISDK_ZIGBEE_SYSTEM_COMMON.

config SILABS_SISDK_ZIGBEE_STACK_DIAGNOSTICS
	bool "Stack Diagnostics"
	depends on SILABS_SISDK_ZIGBEE
	help
	  Generated from zigbee_stack_diagnostics.slcc. Category:
	  Zigbee|Utility.

config SILABS_SISDK_ZIGBEE_STRONG_RANDOM_API_PSA
	bool "Strong Random Api (PSA)"
	depends on SILABS_SISDK_ZIGBEE
	help
	  Generated from zigbee_strong_random_api_psa.slcc. Category:
	  Zigbee|Utility.

config SILABS_SISDK_ZIGBEE_SYSTEM_COMMON
	bool "Application Framework Common"
	depends on SILABS_SISDK_ZIGBEE
	depends on SILABS_SISDK_ZIGBEE_ENHANCED_ROUTING
	depends on SILABS_SISDK_ZIGBEE_PHY_2_4
	help
	  Generated from zigbee_system_common.slcc. Category: Zigbee|Utility.
	  Acyclic component requirements: SILABS_SISDK_ZIGBEE_ENHANCED_ROUTING,
	  SILABS_SISDK_ZIGBEE_PHY_2_4.

config SILABS_SISDK_ZIGBEE_SYSTEM_COMMON_APP_FRAMEWORK
	bool "Zigbee System Common, Application Framework Task"
	depends on SILABS_SISDK_ZIGBEE
	help
	  Generated from zigbee_system_common_app_framework.slcc. Category:
	  Zigbee|Utility.

config SILABS_SISDK_ZIGBEE_UPDATE_TC_LINK_KEY
	bool "Update TC Link Key"
	depends on SILABS_SISDK_ZIGBEE
	help
	  Generated from zigbee_update_tc_link_key.slcc. Category: Zigbee|Zigbee
	  3.0.

config SILABS_SISDK_ZIGBEE_ZCL_CLI
	bool "Zigbee ZCL CLI"
	depends on SILABS_SISDK_ZIGBEE
	depends on SILABS_SISDK_ZIGBEE_CLI
	depends on SILABS_SISDK_ZIGBEE_ZCL_FRAMEWORK_CORE
	help
	  Generated from zigbee_zcl_cli.slcc. Category: Zigbee|Utility. Acyclic
	  component requirements: SILABS_SISDK_ZIGBEE_CLI,
	  SILABS_SISDK_ZIGBEE_ZCL_FRAMEWORK_CORE.

config SILABS_SISDK_ZIGBEE_ZCL_FRAMEWORK_CORE
	bool "ZCL Framework Core"
	depends on SILABS_SISDK_ZIGBEE
	depends on SILABS_SISDK_ZIGBEE_DEVICE_CONFIG
	depends on SILABS_SISDK_ZIGBEE_CLUSTER_SERVICE
	depends on SILABS_SISDK_ZIGBEE_SIGNATURE_DECODE
	depends on SILABS_SISDK_ZIGBEE_SYSTEM_COMMON_APP_FRAMEWORK
	help
	  Generated from zigbee_zcl_framework_core.slcc. Category:
	  Zigbee|Cluster Library. Acyclic component requirements:
	  SILABS_SISDK_ZIGBEE_DEVICE_CONFIG,
	  SILABS_SISDK_ZIGBEE_CLUSTER_SERVICE,
	  SILABS_SISDK_ZIGBEE_SIGNATURE_DECODE,
	  SILABS_SISDK_ZIGBEE_SYSTEM_COMMON_APP_FRAMEWORK.

config SILABS_SISDK_ZIGBEE_ZLL
	bool "Zigbee light link"
	depends on SILABS_SISDK_ZIGBEE
	depends on SILABS_SISDK_ZIGBEE_LIGHT_LINK
	imply SILABS_SISDK_ZIGBEE_ZLL_LIBRARY
	help
	  Generated from zigbee_zll.slcc. Category: Zigbee|Stack. Cyclic
	  component relationships represented as soft implies:
	  SILABS_SISDK_ZIGBEE_ZLL_LIBRARY.

config SILABS_SISDK_ZIGBEE_ZLL_COMMISSIONING_COMMON
	bool "ZLL Commissioning Common"
	depends on SILABS_SISDK_ZIGBEE
	depends on SILABS_SISDK_ZIGBEE_ZLL
	depends on SILABS_SISDK_ZIGBEE_INTERPAN
	help
	  Generated from zigbee_zll_commissioning_common.slcc. Category:
	  Zigbee|Zigbee Light Link. Acyclic component requirements:
	  SILABS_SISDK_ZIGBEE_ZLL, SILABS_SISDK_ZIGBEE_INTERPAN.

config SILABS_SISDK_ZIGBEE_ZLL_COMMISSIONING_SERVER
	bool "ZLL Commissioning Server"
	depends on SILABS_SISDK_ZIGBEE
	depends on SILABS_SISDK_ZIGBEE_ZLL
	depends on SILABS_SISDK_ZIGBEE_INTERPAN
	depends on SILABS_SISDK_ZIGBEE_ZLL_COMMISSIONING_COMMON
	help
	  Generated from zigbee_zll_commissioning_server.slcc. Category:
	  Zigbee|Zigbee Light Link. Acyclic component requirements:
	  SILABS_SISDK_ZIGBEE_ZLL, SILABS_SISDK_ZIGBEE_INTERPAN,
	  SILABS_SISDK_ZIGBEE_ZLL_COMMISSIONING_COMMON.

config SILABS_SISDK_ZIGBEE_ZLL_IDENTIFY_SERVER
	bool "ZLL Identify Server"
	depends on SILABS_SISDK_ZIGBEE
	depends on SILABS_SISDK_ZIGBEE_IDENTIFY
	help
	  Generated from zigbee_zll_identify_server.slcc. Category:
	  Zigbee|Zigbee Light Link. Acyclic component requirements:
	  SILABS_SISDK_ZIGBEE_IDENTIFY.

config SILABS_SISDK_ZIGBEE_ZLL_LEVEL_CONTROL_SERVER
	bool "ZLL Level Control Server Cluster Enhancements"
	depends on SILABS_SISDK_ZIGBEE
	depends on SILABS_SISDK_ZIGBEE_LEVEL_CONTROL
	help
	  Generated from zigbee_zll_level_control_server.slcc. Category:
	  Zigbee|Zigbee Light Link. Acyclic component requirements:
	  SILABS_SISDK_ZIGBEE_LEVEL_CONTROL.

config SILABS_SISDK_ZIGBEE_ZLL_LIBRARY
	bool "Zigbee Light Link (Library)"
	depends on SILABS_SISDK_ZIGBEE
	help
	  Generated from zigbee_zll_library.slcc. Category: Zigbee|Stack.

config SILABS_SISDK_ZIGBEE_ZLL_ON_OFF_SERVER
	bool "ZLL On/Off Server Cluster Enhancements"
	depends on SILABS_SISDK_ZIGBEE
	depends on SILABS_SISDK_ZIGBEE_ON_OFF
	help
	  Generated from zigbee_zll_on_off_server.slcc. Category: Zigbee|Zigbee
	  Light Link. Acyclic component requirements:
	  SILABS_SISDK_ZIGBEE_ON_OFF.

config SILABS_SISDK_ZIGBEE_ZLL_SCENES_SERVER
	bool "ZLL Scenes Server Cluster Enhancements"
	depends on SILABS_SISDK_ZIGBEE
	depends on SILABS_SISDK_ZIGBEE_SCENES
	help
	  Generated from zigbee_zll_scenes_server.slcc. Category: Zigbee|Zigbee
	  Light Link. Acyclic component requirements:
	  SILABS_SISDK_ZIGBEE_SCENES.

config SILABS_SISDK_ZIGBEE_ZLL_UTILITY_SERVER
	bool "ZLL Utility Server Cluster"
	depends on SILABS_SISDK_ZIGBEE
	help
	  Generated from zigbee_zll_utility_server.slcc. Category: Zigbee|Zigbee
	  Light Link.

endmenu
```

## soc/silabs/Kconfig
```kconfig
# Copyright (c) 2024 Silicon Laboratories Inc.
# SPDX-License-Identifier: Apache-2.0

rsource "*/Kconfig"

if SOC_FAMILY_SILABS_S2 || SOC_FAMILY_SILABS_S3 || SOC_FAMILY_SILABS_SIWX91X

endif
```
