## drivers/entropy/Kconfig
```kconfig
# Copyright (c) 2025 Silicon Laboratories Inc.
# SPDX-License-Identifier: Apache-2.0

if ENTROPY_GENERATOR

config ENTROPY_SILABS_CRYPTOACC_TRNG
	bool "Silicon Labs CRYPTOACC TRNG driver"
	default y
	depends on DT_HAS_SILABS_GECKO_TRNG_ENABLED
	depends on PSA_CRYPTO
	depends on SILABS_SISDK_PSA_CRYPTO
	select ENTROPY_HAS_DRIVER
	help
	  This option enables the TRNG based entropy driver for Series 2 devices
	  with VSE (Virtual Secure Engine), i.e. xG22 and xG27.

endif
```

## modules/hal_silabs/simplicity_sdk/Kconfig.zigbee
```kconfig
# Copyright (c) 2026 Silicon Laboratories Inc.
# SPDX-License-Identifier: Apache-2.0

menuconfig ZIGBEE_SILABS
	bool "Silicon Labs Zigbee stack (prebuilt libraries)"
	depends on SOC_GECKO_HAS_RADIO
	depends on ZEPHYR_HAL_SILABS_MODULE_BLOBS || BUILD_ONLY_NO_BLOBS
	select SOC_GECKO_USE_RAIL
	select SILABS_SISDK_PROTOCOL_CRYPTO
	select SILABS_SISDK_SLEEPTIMER
	select SILABS_SISDK_CORE
	help
	  Link the Silicon Labs Zigbee PRO stack prebuilt libraries from the
	  hal_silabs blob bundle. Open-source Zigbee SDK sources and Zephyr
	  runtime glue are still required to produce a working firmware image.

if ZIGBEE_SILABS

config SILABS_SISDK_ZIGBEE
	bool
	default y
	help
	  Internal symbol gating generated Zigbee component Kconfig and sources.

# Aliases for blob/prebuilt options referenced by generated component Kconfig.
config SILABS_SISDK_ZIGBEE_DEBUG_BASIC
	bool
	default y
	depends on ZIGBEE_SILABS_DEBUG_BASIC

config SILABS_SISDK_ZIGBEE_GREEN_POWER
	bool
	default y
	depends on ZIGBEE_SILABS_GP

config SILABS_SISDK_ZIGBEE_LIGHT_LINK
	bool
	default y
	depends on ZIGBEE_SILABS_ZLL

config SILABS_SISDK_ZIGBEE_SOURCE_ROUTE
	bool
	default y
	depends on ZIGBEE_SILABS_SOURCE_ROUTE

config SILABS_SISDK_ZIGBEE_STACK_LEAF
	bool
	default y
	depends on ZIGBEE_SILABS_STACK_LEAF

config SILABS_SISDK_ZIGBEE_STACK_ROUTER
	bool
	default y
	depends on ZIGBEE_SILABS_STACK_ROUTER

config SILABS_SISDK_ZIGBEE_STACK_PRO
	bool
	default y
	depends on ZIGBEE_SILABS_STACK_COORDINATOR

orsource "zigbee/generated/Kconfig.components"

# PSA algorithms required by the OSS security_manager plugin and Zigbee secure
# key storage. Pulled in here so applications do not duplicate mbedtls Kconfig.
config ZIGBEE_SILABS_PSA_CRYPTO
	bool
	default y
	depends on SILABS_SISDK_ZIGBEE_SECURITY_MANAGER
	select PSA_CRYPTO
	select ENTROPY_GENERATOR
	select PSA_WANT_ALG_SHA_256
	select PSA_WANT_ALG_HMAC
	select PSA_WANT_ALG_CMAC
	select PSA_WANT_ALG_CCM
	select PSA_WANT_ALG_ECB_NO_PADDING
	select PSA_WANT_ALG_HKDF
	select PSA_WANT_ALG_ECDSA
	select PSA_WANT_ALG_ECDH
	select PSA_WANT_KEY_TYPE_AES
	select PSA_WANT_KEY_TYPE_RAW_DATA
	select PSA_WANT_KEY_TYPE_ECC_KEY_PAIR_GENERATE
	select PSA_WANT_KEY_TYPE_ECC_KEY_PAIR_IMPORT
	select PSA_WANT_ECC_SECP_R1_256
	select PSA_WANT_ECC_MONTGOMERY_255
	# Persistent Zigbee vault keys (PSA_KEY_PERSISTENCE_DEFAULT) need ITS.
	select SETTINGS
	select SECURE_STORAGE
	select HWINFO

choice ZIGBEE_SILABS_STACK
	prompt "Zigbee stack variant"
	default ZIGBEE_SILABS_STACK_LEAF

config ZIGBEE_SILABS_STACK_LEAF
	bool "Zigbee PRO leaf stack (end device)"

config ZIGBEE_SILABS_STACK_ROUTER
	bool "Zigbee PRO router stack"

config ZIGBEE_SILABS_STACK_COORDINATOR
	bool "Zigbee PRO stack (router / coordinator)"

endchoice

config ZIGBEE_SILABS_RAIL_MUX
	bool "Use RAIL-multiplexed stack library"
	depends on SILABS_SISDK_RAIL_MULTIPROTOCOL
	depends on !ZIGBEE_SILABS_STACK_LEAF
	help
	  Select the rail-mux prebuilt stack variant for router or coordinator
	  roles when RAIL multiprotocol is enabled (for example Zigbee with
	  Bluetooth LE). The leaf stack has no rail-mux blob variant.

config ZIGBEE_SILABS_R23_SUPPORT
	bool "Zigbee R23 support library"
	default y
	help
	  Link libzigbee-r23-support.a for Zigbee 3.0 / R23 features.

config ZIGBEE_SILABS_CBKE
	bool "Zigbee CBKE security libraries"
	default y
	help
	  Link the Certificate-Based Key Establishment (CBKE) prebuilt
	  libraries required for Zigbee 3.0 security.

config ZIGBEE_SILABS_DEBUG_BASIC
	bool "Zigbee basic debug library"
	default y
	help
	  Link libzigbee-debug-basic.a.

config ZIGBEE_SILABS_DEBUG_EXTENDED
	bool "Zigbee extended debug library"
	help
	  Link libzigbee-debug-extended.a.

config ZIGBEE_SILABS_SOURCE_ROUTE
	bool "Zigbee source routing library"
	default y if ZIGBEE_SILABS_STACK_ROUTER || ZIGBEE_SILABS_STACK_COORDINATOR
	help
	  Link libzigbee-source-route.a. Typically used on routers and
	  coordinators, not leaf end devices.

config ZIGBEE_SILABS_GP
	bool "Zigbee Green Power library"
	help
	  Link libzigbee-gp.a.

config ZIGBEE_SILABS_ZLL
	bool "Zigbee Light Link library"
	help
	  Link libzigbee-zll.a.

config ZIGBEE_SILABS_DYNAMIC_COMMISSIONING
	bool "Zigbee dynamic commissioning library"
	help
	  Link libzigbee-dynamic-commissioning.a.

config SILABS_ZIGBEE_TOKEN_NVS
	bool "Zephyr NVS backend for Zigbee stack tokens"
	default y
	select FLASH
	select FLASH_MAP
	select NVS
	help
	  Store Silicon Labs Zigbee stack tokens in a Zephyr NVS partition
	  instead of the Simplicity SDK token manager and NVM3. Prefers a
	  zb_token_partition node when present; otherwise uses storage_partition.
	  When PSA secure storage also uses storage_partition, provide a
	  dedicated zb_token_partition so the two NVS mounts do not collide.

if SILABS_ZIGBEE_TOKEN_NVS

config SILABS_ZIGBEE_TOKEN_NVS_SECTOR_COUNT
	int "NVS sector count for Zigbee token storage"
	default 2
	help
	  Number of flash sectors used by the Zigbee token NVS filesystem.
	  Must fit within zb_token_partition (or storage_partition) size.

config SILABS_ZIGBEE_TOKEN_NVS_MAX_SIZE
	int "Maximum Zigbee token payload size in bytes"
	default 256
	help
	  Maximum token data length supported by the NVS shim.

endif # SILABS_ZIGBEE_TOKEN_NVS

config SILABS_ZIGBEE_RUNTIME
	bool "Zigbee stack runtime init and tick glue"
	default y
	depends on SILABS_SISDK_ZIGBEE_SYSTEM_COMMON
	help
	  Call sli_zigbee_stack_init_callback() and
	  sli_zigbee_app_framework_init_callback(), and drive periodic stack
	  and application framework ticks on Zephyr.

if SILABS_ZIGBEE_RUNTIME

config SILABS_ZIGBEE_RUNTIME_THREAD
	bool "Run Zigbee ticks in a dedicated thread"
	default y
	help
	  When enabled, sl_zigbee_runtime_start() creates a background thread
	  that calls sl_zigbee_runtime_process_once() periodically.

config SILABS_ZIGBEE_RUNTIME_THREAD_STACK_SIZE
	int "Zigbee runtime thread stack size"
	default 4096
	depends on SILABS_ZIGBEE_RUNTIME_THREAD

config SILABS_ZIGBEE_RUNTIME_THREAD_PRIORITY
	int "Zigbee runtime thread priority"
	default 5
	depends on SILABS_ZIGBEE_RUNTIME_THREAD

config SILABS_ZIGBEE_RUNTIME_DEFAULT_TICK_MS
	int "Default Zigbee tick period when no AF events are scheduled"
	default 10

config SILABS_ZIGBEE_RUNTIME_MAX_SLEEP_MS
	int "Maximum sleep between Zigbee ticks"
	default 100

endif # SILABS_ZIGBEE_RUNTIME

endif # ZIGBEE_SILABS
```
