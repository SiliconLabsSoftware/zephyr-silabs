## soc/silabs/silabs_siwx917/Kconfig
```kconfig
# Copyright (c) 2025 Silicon Laboratories Inc.
# SPDX-License-Identifier: Apache-2.0

if SOC_FAMILY_SILABS_SIWX91X

config SILABS_WISECONNECT_PSA_CRYPTO
	bool "TF-PSA-Crypto driver with hardware acceleration"
	depends on MBEDTLS_PSA_CRYPTO_C
	select SILABS_SIWX91X_NWP
	help
	  Set if the driver dispatch implementation with support for hardware
	  accelerated crypto operations is used.

endif
```

## soc/silabs/silabs_siwx917/Kconfig.defconfig
```kconfig
# Copyright (c) 2026 Silicon Laboratories Inc.
# SPDX-License-Identifier: Apache-2.0

if SOC_FAMILY_SILABS_SIWX91X

configdefault TF_PSA_CRYPTO_DISPATCH_DIR
	default "${ZEPHYR_HAL_SILABS_MODULE_DIR}/simplicity_sdk/util/third_party/mbedtls/dispatch" \
		if SILABS_WISECONNECT_PSA_CRYPTO

configdefault TF_PSA_CRYPTO_DRIVER_CONFIG_FILE
	default "sl_psa_crypto_config_zephyr.h" if SILABS_WISECONNECT_PSA_CRYPTO

endif # SOC_FAMILY_SILABS_SIWX91X
```
