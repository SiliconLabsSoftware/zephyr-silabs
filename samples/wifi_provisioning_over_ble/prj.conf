## CMakeLists.txt
```
# SPDX-License-Identifier: Apache-2.0

cmake_minimum_required(VERSION 3.20.0)

find_package(Zephyr REQUIRED HINTS $ENV{ZEPHYR_BASE})
project(wifi_provisioning_over_ble)

target_sources(app PRIVATE
  src/main.c
  src/wifi_app_util.c
)
```

## prj.conf
```kconfig
CONFIG_NETWORKING=y
CONFIG_WIFI=y
CONFIG_NET_MGMT=y
CONFIG_WIFI_SILABS_SIWX91X_NET_STACK_NATIVE=y

CONFIG_NET_IPV4=y
CONFIG_NET_ARP=y
CONFIG_NET_DHCPV4=y
CONFIG_INIT_STACKS=y
CONFIG_NET_MGMT_EVENT=y

CONFIG_REQUIRES_FULL_LIBC=y
CONFIG_HEAP_MEM_POOL_SIZE=8192
CONFIG_THREAD_NAME=y

#BLE related configurations
CONFIG_SYSTEM_WORKQUEUE_STACK_SIZE=4096
CONFIG_MAIN_STACK_SIZE=4096

CONFIG_BT=y
CONFIG_BT_PERIPHERAL=y
CONFIG_BT_DEVICE_NAME="BLE_CONFIGURATOR"
CONFIG_BT_DEVICE_APPEARANCE=833

CONFIG_BT_BUF_ACL_RX_SIZE=255
CONFIG_BT_BUF_ACL_TX_SIZE=251
CONFIG_BT_BUF_CMD_TX_SIZE=255
CONFIG_BT_BUF_EVT_DISCARDABLE_SIZE=255

CONFIG_BT_L2CAP_TX_MTU=247
CONFIG_BT_GATT_CLIENT=y
```

## src/app_config.h
```c
#define SUCCESS 0

#define WIFI_SHELL_MGMT_EVENTS_COMMON                                                              \
	(NET_EVENT_WIFI_SCAN_DONE | NET_EVENT_WIFI_DISCONNECT_COMPLETE |                           \
	 NET_EVENT_WIFI_CONNECT_RESULT | NET_EVENT_WIFI_DISCONNECT_RESULT | NET_EVENT_WIFI_TWT |   \
	 NET_EVENT_WIFI_RAW_SCAN_RESULT | NET_EVENT_WIFI_AP_ENABLE_RESULT |                        \
	 NET_EVENT_WIFI_AP_DISABLE_RESULT | NET_EVENT_WIFI_AP_STA_CONNECTED |                      \
	 NET_EVENT_WIFI_AP_STA_DISCONNECTED)

#ifdef CONFIG_WIFI_MGMT_RAW_SCAN_RESULTS_ONLY
#define WIFI_SHELL_MGMT_EVENTS (WIFI_SHELL_MGMT_EVENTS_COMMON)
#else
#define WIFI_SHELL_MGMT_EVENTS (WIFI_SHELL_MGMT_EVENTS_COMMON | NET_EVENT_WIFI_SCAN_RESULT)
#endif /* CONFIG_WIFI_MGMT_RAW_SCAN_RESULTS_ONLY */

static void start_dhcpv4_client(struct net_if *iface, void *user_data);
static void wifi_mgmt_event_handler(struct net_mgmt_event_callback *cb, uint64_t mgmt_event,
				    struct net_if *iface);
```

## src/wifi_app_util.c
```c
/* SPDX-License-Identifier: Apache-2.0 */
/* SPDX-FileCopyrightText: 2025 Silicon Laboratories Inc. */

#include "wifi_app_util.h"

uint8_t wifi_app_map_security_to_siconnect(enum wifi_security_type security)
{
	uint8_t code = 0xFF; /* Unknown */

	switch (security) {
	case WIFI_SECURITY_TYPE_NONE:
		code = WIFI_APP_SEC_CODE_OPEN;
		break;
	case WIFI_SECURITY_TYPE_WPA_PSK:
		code = WIFI_APP_SEC_CODE_WPA;
		break;
	case WIFI_SECURITY_TYPE_PSK:
	case WIFI_SECURITY_TYPE_PSK_SHA256:
	case WIFI_SECURITY_TYPE_FT_PSK:
		code = WIFI_APP_SEC_CODE_WPA2_PSK;
		break;
	case WIFI_SECURITY_TYPE_WEP:
		code = WIFI_APP_SEC_CODE_WEP;
		break;
	case WIFI_SECURITY_TYPE_EAP:
	case WIFI_SECURITY_TYPE_EAP_PEAP_MSCHAPV2:
	case WIFI_SECURITY_TYPE_EAP_PEAP_GTC:
	case WIFI_SECURITY_TYPE_EAP_TTLS_MSCHAPV2:
	case WIFI_SECURITY_TYPE_EAP_PEAP_TLS:
	case WIFI_SECURITY_TYPE_FT_EAP:
		code = WIFI_APP_SEC_CODE_WPA2_EAP;
		break;
	case WIFI_SECURITY_TYPE_FT_EAP_SHA384:
		code = WIFI_APP_SEC_CODE_WPA3_EAP;
		break;
	case WIFI_SECURITY_TYPE_WPA_AUTO_PERSONAL:
		code = WIFI_APP_SEC_CODE_WPA_WPA2_MIXED;
		break;
	case WIFI_SECURITY_TYPE_SAE_AUTO:
		code = WIFI_APP_SEC_CODE_WPA3_TRANSITION;
		break;
	case WIFI_SECURITY_TYPE_SAE:
	case WIFI_SECURITY_TYPE_SAE_H2E:
	case WIFI_SECURITY_TYPE_FT_SAE:
		code = WIFI_APP_SEC_CODE_WPA3;
		break;
	default:
		code = 0xFF;
		break;
	}
	return code;
}

enum wifi_security_type wifi_app_map_security_from_siconnect(uint8_t app_code)
{
	enum wifi_security_type security = WIFI_SECURITY_TYPE_UNKNOWN;

	/* Compat: treat 3 (from some app builds), 7 and 8 as WPA3 (SAE_AUTO) */
	switch (app_code) {
	case WIFI_APP_SEC_CODE_OPEN:
		security = WIFI_SECURITY_TYPE_NONE;
		break;
	case WIFI_APP_SEC_CODE_WPA:
		security = WIFI_SECURITY_TYPE_WPA_PSK;
		break;
	case WIFI_APP_SEC_CODE_WPA2_PSK:
		security = WIFI_SECURITY_TYPE_PSK;
		break;
	case WIFI_APP_SEC_CODE_WEP:
		security = WIFI_SECURITY_TYPE_SAE_AUTO; /* prefer WPA3 over WEP for app interop */
		break;
	/* No explicit code 4 in our map; keep 5 as EAP for older apps */
	case WIFI_APP_SEC_CODE_WPA2_EAP:
		security = WIFI_SECURITY_TYPE_EAP;
		break;
	case WIFI_APP_SEC_CODE_WPA_WPA2_MIXED:
		security = WIFI_SECURITY_TYPE_WPA_AUTO_PERSONAL;
		break;
	case WIFI_APP_SEC_CODE_WPA3:
	case WIFI_APP_SEC_CODE_WPA3_TRANSITION:
		security = WIFI_SECURITY_TYPE_SAE_AUTO;
		break;
	case WIFI_APP_SEC_CODE_WPA3_EAP:
	case WIFI_APP_SEC_CODE_WPA3_EAP_192:
		security = WIFI_SECURITY_TYPE_FT_EAP_SHA384;
		break;
	default:
		security = WIFI_SECURITY_TYPE_UNKNOWN;
		break;
	}
	return security;
}
```

## src/wifi_app_util.h
```c
/* SPDX-License-Identifier: Apache-2.0 */
/* SPDX-FileCopyrightText: 2025 Silicon Laboratories Inc. */

#pragma once

#include <zephyr/net/wifi.h>
#include <stdint.h>

/* Si-Connect app security code values */
#define WIFI_APP_SEC_CODE_OPEN            0
#define WIFI_APP_SEC_CODE_WPA             1
#define WIFI_APP_SEC_CODE_WPA2_PSK        2
#define WIFI_APP_SEC_CODE_WEP             3
#define WIFI_APP_SEC_CODE_WPA2_EAP        5
#define WIFI_APP_SEC_CODE_WPA_WPA2_MIXED  6
#define WIFI_APP_SEC_CODE_WPA3            7
#define WIFI_APP_SEC_CODE_WPA3_TRANSITION 8
#define WIFI_APP_SEC_CODE_WPA3_EAP        9
#define WIFI_APP_SEC_CODE_WPA3_EAP_192    10

/* Maps Zephyr security enum to Si-Connect app codes. */
uint8_t wifi_app_map_security_to_siconnect(enum wifi_security_type security);

/* Maps Si-Connect app codes to Zephyr security enum. */
enum wifi_security_type wifi_app_map_security_from_siconnect(uint8_t app_code);
```
