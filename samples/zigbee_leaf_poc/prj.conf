## CMakeLists.txt
```
# Copyright (c) 2026 Silicon Laboratories Inc.
# SPDX-License-Identifier: Apache-2.0

cmake_minimum_required(VERSION 3.20.0)

find_package(Zephyr REQUIRED HINTS $ENV{ZEPHYR_BASE})
project(zigbee_leaf_poc)

target_sources(app PRIVATE src/main.c)
```

## sample.yaml
```
sample:
  name: Silicon Labs Zigbee leaf PoC
  description: >
    Downstream proof-of-concept that links the Silicon Labs Zigbee PRO leaf
    stack prebuilt libraries. Runtime Zigbee application glue is not included.
tests:
  sample.zigbee.leaf_poc:
    harness: none
    integration_platforms:
      - xg24_rb4187c
    tags:
      - zigbee
    build_only: true
```

## prj.conf
```kconfig
CONFIG_ZIGBEE_SILABS=y
CONFIG_ZIGBEE_SILABS_STACK_LEAF=y
CONFIG_ZIGBEE_SILABS_R23_SUPPORT=y
CONFIG_ZIGBEE_SILABS_CBKE=y
CONFIG_ZIGBEE_SILABS_DEBUG_BASIC=y

CONFIG_LOG=y
CONFIG_PRINTK=y
```

## src/main.c
```c
/*
 * Copyright (c) 2026 Silicon Laboratories Inc.
 *
 * SPDX-License-Identifier: Apache-2.0
 */

#include <zephyr/kernel.h>
#include <zephyr/logging/log.h>

LOG_MODULE_REGISTER(zigbee_leaf_poc, LOG_LEVEL_INF);

int main(void)
{
	LOG_INF("Silicon Labs Zigbee leaf PoC");
	LOG_INF("Prebuilt stack libraries are linked via CONFIG_ZIGBEE_SILABS");
	LOG_INF("Add Zigbee SDK sources and runtime glue for a functional network");

	while (true) {
		k_sleep(K_SECONDS(5));
	}

	return 0;
}
```
