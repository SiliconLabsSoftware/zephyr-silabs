## CMakeLists.txt
```
# Copyright (c) 2025 Silicon Laboratories Inc.
# SPDX-License-Identifier: Apache-2.0

cmake_minimum_required(VERSION 3.20.0)

find_package(Zephyr REQUIRED HINTS $ENV{ZEPHYR_BASE})
project(siwx91x_ota)

target_sources(app PRIVATE src/main.c)
```

## Kconfig
```
# Copyright (c) 2025 Silicon Laboratories Inc.
# SPDX-License-Identifier: Apache-2.0

mainmenu "SiWx91x OTA Configuration"

menu "SiWx91x OTA application options"

config OTA_WIFI_SSID
	string "WiFi SSID"
	default "your_ssid"
	help
	  WiFi SSID for the network to connect to.

config OTA_WIFI_PSK
	string "WiFi PSK"
	default "your_psk"
	help
	  WiFi PSK (password) for the network to connect to.

config OTA_UPDATE_URL
	string "OTA update URL"
	default "https://example.com:443/firmware.rps"
	help
	  The full URL for the OTA firmware update.

endmenu

source "Kconfig.zephyr"
```

## sample.yaml
```
# Copyright (c) 2025 Silicon Laboratories Inc.
# SPDX-License-Identifier: Apache-2.0

sample:
  name: HTTP/HTTPS OTA
  description: HTTP/HTTPS OTA firmware update application for SiWx917
tests:
  sample.net.http_otaf:
    harness: net
    filter: CONFIG_SOC_FAMILY_SILABS_SIWX91X
    tags:
      - net
      - wifi
      - http
      - tls
    integration_platforms:
      - siwx917_rb4338a
```

## prj.conf
```kconfig
# Copyright (c) 2025 Silicon Laboratories Inc.
# SPDX-License-Identifier: Apache-2.0

# Network Stack Configuration
CONFIG_NETWORKING=y
CONFIG_NET_TCP=y
CONFIG_NET_IPV4=y
CONFIG_NET_IPV6=y

# WiFi Configuration
CONFIG_WIFI=y
CONFIG_NET_DHCPV4=y
# Memory and Threading
CONFIG_MAIN_STACK_SIZE=4098

# Socket Support
CONFIG_NET_SOCKETS=y

# HTTP Client Configuration
CONFIG_HTTP_CLIENT=y
CONFIG_HTTP_PARSER_URL=y

# TLS Security Configuration
CONFIG_MBEDTLS=y
CONFIG_MBEDTLS_BUILTIN=y
CONFIG_NET_SOCKETS_SOCKOPT_TLS=y
CONFIG_MBEDTLS_SSL_MAX_CONTENT_LEN=4096

# TLS Protocol and Cipher Configuration
CONFIG_MBEDTLS_CIPHERSUITE_TLS_ECDHE_ECDSA_WITH_AES_128_GCM_SHA256=y
CONFIG_MBEDTLS_CIPHERSUITE_TLS_ECDHE_RSA_WITH_AES_128_GCM_SHA256=y
CONFIG_MBEDTLS_CIPHERSUITE_TLS1_3_AES_128_GCM_SHA256=y
CONFIG_MBEDTLS_CIPHERSUITE_TLS1_3_CHACHA20_POLY1305_SHA256=y
CONFIG_MBEDTLS_SSL_TLS1_3_KEY_EXCHANGE_MODE_EPHEMERAL_ENABLED=y

CONFIG_ASSERT=y

# DNS configuration
CONFIG_DNS_RESOLVER=y

CONFIG_SIWX91X_FIRMWARE_UPGRADE=y
CONFIG_REBOOT=y
```

## src/main.c
```c
/*
 * Copyright (c) 2025 Silicon Laboratories Inc.
 *
 * SPDX-License-Identifier: Apache-2.0
 */

#include <stdbool.h>
#include <stddef.h>
#include <string.h>
#include <stdio.h>
#include <stdlib.h>
#include <errno.h>
#include <zephyr/net/wifi_mgmt.h>
#include <zephyr/net/socket.h>
#include <zephyr/net/http/client.h>
#include <zephyr/sys/reboot.h>
#include "firmware_upgradation.h"
#include "sl_wifi.h"

/* Event flags */
#define NET_IPV4_EVENT_READY   BIT(1)
#define NET_IPV6_EVENT_READY   BIT(2)
#define WIFI_SCAN_DONE_EVENT   BIT(3)
#define WIFI_SECURITY_TYPE_SET BIT(4)

struct ota_url {
	bool use_tls;
	char *host;
	char *path;
	char *port;
};

struct app_ctx {
	enum wifi_security_type security_type;
	const char *wifi_ssid;
	const char *wifi_psk;
	struct k_event events;
	struct net_mgmt_event_callback mgmt_cb_ipv4;
	struct net_mgmt_event_callback mgmt_cb_ipv6;
	struct net_mgmt_event_callback mgmt_cb_wlan_scan_result;
	struct net_mgmt_event_callback mgmt_cb_wlan_scan_done;
	struct net_mgmt_event_callback mgmt_cb_wlan_connect;
	struct net_mgmt_event_callback mgmt_cb_wlan_disconnect;
	struct net_mgmt_event_callback mgmt_cb_dns;
	volatile bool ipv4_addr_config_done;
	volatile bool ipv6_addr_config_done;
	volatile bool connected;
	int sock;
	struct ota_url url;
	int http_status_code;
	uint32_t image_size;
	int range_start;

	/* Flash buffer for firmware chunks */
	uint8_t flash_buffer[1024];
	uint32_t flash_buffer_len;

	/* Separate HTTP receive buffer to avoid conflicts */
	uint8_t http_recv_buffer[1024];
};

static char *ota_get_url_field(const char *url, struct http_parser_url parser, int field)
{
	int len = parser.field_data[field].len;
	const char *ptr = url + parser.field_data[field].off;
	char *out;

	__ASSERT(parser.field_set & BIT(field), "Invalid URL");
	out = malloc(len + 1);
	if (out != NULL) {
		memcpy(out, ptr, len);
		out[len] = '\0';
	}
	return out;
}

/*
 * @brief Parse URL into host, path and port components
 */
static int ota_parse_url(struct ota_url *url)
{
	struct http_parser_url parser;
	static char url_str[256];
	const char *schema;
	size_t url_len;
	int ret;

	url_len = strlen(CONFIG_OTA_UPDATE_URL);
	if (url_len >= sizeof(url_str)) {
		printf("URL too long (max %zu bytes)\n", sizeof(url_str) - 1);
		return -EINVAL;
	}
	memcpy(url_str, CONFIG_OTA_UPDATE_URL, url_len + 1);

	http_parser_url_init(&parser);
	ret = http_parser_parse_url(url_str, url_len, 0, &parser);
	__ASSERT(ret == 0, "URL parsing failed");

	url->path = ota_get_url_field(url_str, parser, UF_PATH);
	schema = ota_get_url_field(url_str, parser, UF_SCHEMA);
	url->use_tls = (strcmp(schema, "https") == 0);
	free((void *)schema);

	if ((parser.field_set & BIT(UF_PORT)) == 0) {
		url->port = url->use_tls ? "443" : "80";
	} else {
		url->port = ota_get_url_field(url_str, parser, UF_PORT);
	}
	url->host = ota_get_url_field(url_str, parser, UF_HOST);

	printf("Retrieve %s://%s:%s%s\n", url->use_tls ? "https" : "http", url->host, url->port,
	       url->path);
	return 0;
}

static void ota_ipv4_event_handler(struct net_mgmt_event_callback *cb, uint64_t mgmt_event,
				   struct net_if *iface)
{
	struct app_ctx *ctx = CONTAINER_OF(cb, struct app_ctx, mgmt_cb_ipv4);
	char addr[INET_ADDRSTRLEN];

	net_addr_ntop(AF_INET, cb->info, addr, sizeof(addr));
	if (mgmt_event == NET_EVENT_IPV4_ADDR_ADD) {
		printf("Added IPv4 Address: %s\n", addr);
		ctx->ipv4_addr_config_done = true;
		k_event_post(&ctx->events, NET_IPV4_EVENT_READY);
	} else {
		ctx->ipv4_addr_config_done = false;
		printf("Removed IPv4 Address: %s\n", addr);
	}
}

static void ota_ipv6_event_handler(struct net_mgmt_event_callback *cb, uint64_t mgmt_event,
				   struct net_if *iface)
{
	struct app_ctx *ctx = CONTAINER_OF(cb, struct app_ctx, mgmt_cb_ipv6);
	char addr[INET6_ADDRSTRLEN];

	net_addr_ntop(AF_INET6, cb->info, addr, sizeof(addr));
	if (mgmt_event == NET_EVENT_IPV6_ADDR_ADD) {
		printf("Added IPv6 Address: %s\n", addr);
		k_event_post(&ctx->events, NET_IPV6_EVENT_READY);
		ctx->ipv6_addr_config_done = true;
	} else {
		printf("Removed IPv6 Address: %s\n", addr);
		ctx->ipv6_addr_config_done = false;
	}
}

static void ota_dns_event_handler(struct net_mgmt_event_callback *cb, uint64_t mgmt_event,
				  struct net_if *iface)
{
	const struct sockaddr *entry = cb->info;
	char addr[INET6_ADDRSTRLEN];
	const char *op;

	if (mgmt_event == NET_EVENT_DNS_SERVER_ADD) {
		op = "Added";
	} else {
		op = "Removed";
	}
	if (entry->sa_family == AF_INET) {
		net_addr_ntop(AF_INET, &net_sin(entry)->sin_addr, addr, sizeof(addr));
	} else if (entry->sa_family == AF_INET6) {
		net_addr_ntop(AF_INET6, &net_sin6(entry)->sin6_addr, addr, sizeof(addr));
	} else {
		/* Use snprintf instead of strcpy: a defensive best-practice change.
		 * Although the literal "<unknown format>" (16 chars + NUL) fits safely
		 * within addr[INET6_ADDRSTRLEN] (46 bytes), snprintf with an explicit
		 * size bound prevents overflow if the string or buffer size changes in
		 * the future, and silences static-analysis tools that flag strcpy
		 * unconditionally.
		 */
		snprintf(addr, sizeof(addr), "<unknown format>");
	}
	printf("%s DNS Address: %s\n", op, addr);
}

static void ota_handle_wifi_scan_result(struct net_mgmt_event_callback *cb, uint64_t mgmt_event,
					struct net_if *iface)
{
	const struct wifi_scan_result *entry = (const struct wifi_scan_result *)cb->info;
	uint8_t mac_string_buf[sizeof("xx:xx:xx:xx:xx:xx")];
	struct app_ctx *ctx = CONTAINER_OF(cb, struct app_ctx, mgmt_cb_wlan_scan_result);

	if (entry->ssid_length == strlen(ctx->wifi_ssid) &&
	    strncmp(entry->ssid, ctx->wifi_ssid, entry->ssid_length) == 0) {
		ctx->security_type = entry->security;
		k_event_post(&ctx->events, WIFI_SECURITY_TYPE_SET);
	}

	snprintf(mac_string_buf, sizeof(mac_string_buf), "%02x:%02x:%02x:%02x:%02x:%02x",
		 entry->mac[0], entry->mac[1], entry->mac[2], entry->mac[3], entry->mac[4],
		 entry->mac[5]);

	printf("%-32s | %-4u (%-6s) | %-4d | %-15s | %-17s | %-8s\n", entry->ssid, entry->channel,
	       wifi_band_txt(entry->band), entry->rssi, wifi_security_txt(entry->security),
	       mac_string_buf, wifi_mfp_txt(entry->mfp));
}

static void ota_handle_wifi_scan_done(struct net_mgmt_event_callback *cb, uint64_t mgmt_event,
				      struct net_if *iface)
{
	struct app_ctx *ctx = CONTAINER_OF(cb, struct app_ctx, mgmt_cb_wlan_scan_done);
	const struct wifi_status *status = (const struct wifi_status *)cb->info;

	if (status->status) {
		printf("Scan request failed (%d)\n", status->status);
	}

	k_event_post(&ctx->events, WIFI_SCAN_DONE_EVENT);
}

static void ota_handle_wifi_connect_result(struct net_mgmt_event_callback *cb, uint64_t mgmt_event,
					   struct net_if *iface)
{
	const struct wifi_status *status = (const struct wifi_status *)cb->info;
	struct app_ctx *ctx = CONTAINER_OF(cb, struct app_ctx, mgmt_cb_wlan_connect);

	if (status->status) {
		ctx->connected = false;
		ctx->security_type = WIFI_SECURITY_TYPE_PSK;
	} else {
		printf("Connected to Wi-Fi\n");
		ctx->connected = true;
	}
}

static void ota_handle_wifi_disconnect_result(struct net_mgmt_event_callback *cb,
					      uint64_t mgmt_event, struct net_if *iface)
{
	const struct wifi_status *status = (const struct wifi_status *)cb->info;
	struct app_ctx *ctx = CONTAINER_OF(cb, struct app_ctx, mgmt_cb_wlan_disconnect);

	printf("Disconnection reason: %d\n", status->disconn_reason);
	ctx->connected = false;
	ctx->security_type = WIFI_SECURITY_TYPE_PSK;
}

static int ota_wifi_start_scan(struct app_ctx *ctx)
{
	struct net_if *iface = net_if_get_first_wifi();
	struct wifi_scan_params params = {};
	int ret;

	printf("%-32s | %-13s | %-4s | %-15s | %-17s | %-8s\n", "SSID", "Chan (Band)", "RSSI",
	       "Security", "BSSID", "MFP");
	ret = net_mgmt(NET_REQUEST_WIFI_SCAN, iface, &params, sizeof(params));
	return ret;
}

/*
 * @brief Connect to WiFi network using context configuration
 */
static int ota_wifi_connect(struct app_ctx *ctx)
{
	struct wifi_connect_req_params cnx_params = {
		.channel = WIFI_CHANNEL_ANY,
		.band = 0,
		.security = ctx->security_type,
		.psk_length = strlen(ctx->wifi_psk),
		.psk = (uint8_t *)ctx->wifi_psk,
		.ssid_length = strlen(ctx->wifi_ssid),
		.ssid = (uint8_t *)ctx->wifi_ssid
	};
	struct net_if *iface = net_if_get_first_wifi();
	int ret;

	ret = net_mgmt(NET_REQUEST_WIFI_CONNECT, iface, &cnx_params,
		       sizeof(struct wifi_connect_req_params));
	if (ret) {
		printf("Connection request failed: %s\n", strerror(-ret));
	}
	return ret;
}

/*
 * @brief Wait for IP configuration to complete
 */
static int ota_wait_for_ip_config(struct app_ctx *ctx)
{
	int ret;

	if (IS_ENABLED(CONFIG_NET_IPV4)) {
		ret = k_event_wait_safe(&ctx->events, NET_IPV4_EVENT_READY, false, K_SECONDS(30));
	} else {
		ret = k_event_wait_safe(&ctx->events, NET_IPV6_EVENT_READY, false, K_SECONDS(30));
	}
	if (!ret && IS_ENABLED(CONFIG_NET_IPV6)) {
		ret = k_event_wait_safe(&ctx->events, NET_IPV6_EVENT_READY, false, K_NO_WAIT);
	}
	return (ret > 0) ? 0 : -ETIMEDOUT;
}

/*
 * @brief Connect to OTA server
 */
static int ota_connect_to_server(struct app_ctx *ctx)
{
	int peer_verify = TLS_PEER_VERIFY_NONE;
	struct zsock_addrinfo *res;
	int ret;

	ret = zsock_getaddrinfo(ctx->url.host, ctx->url.port, NULL, &res);
	if (ret != 0) {
		printf("Cannot resolve %s:%s: %s\n", ctx->url.host, ctx->url.port,
		       zsock_gai_strerror(ret));
		return -EINVAL;
	}

	if (ctx->url.use_tls) {
		ctx->sock = zsock_socket(res->ai_family, SOCK_STREAM, IPPROTO_TLS_1_2);
		if (ctx->sock < 0) {
			goto error;
		}
		ret = zsock_setsockopt(ctx->sock, SOL_TLS, TLS_PEER_VERIFY, &peer_verify,
				       sizeof(peer_verify));
		if (ret < 0) {
			goto error;
		}
	} else {
		/* Use regular TCP for HTTP */
		ctx->sock = zsock_socket(res->ai_family, SOCK_STREAM, IPPROTO_TCP);
		if (ctx->sock < 0) {
			goto error;
		}
	}

	/* Connect to the server */
	ret = zsock_connect(ctx->sock, res->ai_addr, res->ai_addrlen);
	if (ret < 0) {
		printf("Connection failed: %s\n", strerror(errno));
		goto error;
	}

	printf("Connected to %s:%s\n", ctx->url.host, ctx->url.port);
	zsock_freeaddrinfo(res);
	return 0;

error:
	zsock_close(ctx->sock);
	ctx->sock = -1;
	zsock_freeaddrinfo(res);
	return -errno;
}

/*
 * @brief HTTP response callback - processes firmware chunks
 */
static int ota_http_response_cb(struct http_response *rsp, enum http_final_call final_data,
				void *user_data)
{
	struct app_ctx *ctx = (struct app_ctx *)user_data;

	ctx->http_status_code = rsp->http_status_code;
	ctx->image_size = rsp->content_range.total;

	/* Bounds check using subtraction to avoid unsigned integer overflow:
	 * The original form (flash_buffer_len + body_frag_len > sizeof(flash_buffer))
	 * is unsafe because both operands are unsigned 32-bit values — if their sum
	 * exceeds UINT32_MAX it wraps to a small value, making the guard pass even
	 * when the combined write would overflow the buffer.
	 * Rewriting as (body_frag_len > sizeof(flash_buffer) - flash_buffer_len)
	 * computes remaining space first; this subtraction is always safe because
	 * flash_buffer_len is kept <= sizeof(flash_buffer) by invariant.
	 */
	if (rsp->body_frag_len > sizeof(ctx->flash_buffer) - ctx->flash_buffer_len) {
		return -ENODATA;
	}
	memcpy(ctx->flash_buffer + ctx->flash_buffer_len, rsp->body_frag_start, rsp->body_frag_len);
	ctx->flash_buffer_len += rsp->body_frag_len;

	return 0;
}

/*
 * @brief Download firmware chunk from server
 */
static int ota_download_firmware_chunk(struct app_ctx *ctx)
{
	char range_header[64];
	char *headers[2] = { range_header, NULL };
	int range_end;
	int ret;
	struct http_request req = {
		.method = HTTP_GET,
		.url = ctx->url.path,
		.header_fields = (const char *const *) headers,
		.host = ctx->url.host,
		.protocol = "HTTP/1.1",
		.response = ota_http_response_cb,
		.recv_buf = ctx->http_recv_buffer,
		.recv_buf_len = sizeof(ctx->http_recv_buffer)
	};

	ctx->flash_buffer_len = 0;
	ctx->http_status_code = 0;

	if (ctx->image_size > 0 && ctx->range_start >= (int)ctx->image_size) {
		return -ENODATA;
	}

	range_end = ctx->range_start + sizeof(ctx->flash_buffer) - 1;
	if (ctx->range_start) {
		range_end = MIN(range_end, ctx->image_size);
	}

	/* Prepare headers */
	snprintf(range_header, sizeof(range_header), "Range: bytes=%d-%d\r\n", ctx->range_start,
		 range_end);

	/* Send request */
	ret = http_client_req(ctx->sock, &req, 3000, ctx);
	if (ret < 0) {
		printf("HTTP request failed: %s, requested range=%d-%d\n", strerror(-ret),
		       ctx->range_start, range_end);
		return ret;
	}

	/* Handle HTTP status codes - centralized error management */
	if (ctx->http_status_code >= 300) {
		printf("HTTP error %d, requested range=%d-%d\n", ctx->http_status_code,
		       ctx->range_start, range_end);
		return -EPROTO;
	}
	return 0;
}

/*
 * @brief Process firmware update data packets
 */
static int ota_load_firmware(struct app_ctx *ctx)
{
	uint32_t ota_calc_image_size = 0;
	uint32_t status = 0;
	int buf_offset = 0;

	__ASSERT(ctx->flash_buffer_len > 0, "No firmware data to process");

	if (ctx->range_start == 0) {
		buf_offset = sizeof(sl_wifi_firmware_header_t);
		status = sl_wifi_get_firmware_size(ctx->flash_buffer, &ota_calc_image_size);
		if (status != SL_STATUS_OK) {
			printf("Unable to fetch firmware size. Status: 0x%08x\n", status);
			return -EIO;
		}

		if (ctx->image_size != ota_calc_image_size) {
			printf("Corrupted payload (image size mismatch: %u bytes != %u bytes)\n",
			       ctx->image_size, ota_calc_image_size);
			return -EINVAL;
		}

		printf("Firmware size: %u bytes\n", ctx->image_size);

		status = sl_si91x_fwup_start(ctx->flash_buffer);
		if (status != SL_STATUS_OK) {
			printf("Failed to load firmware header (0x%08x)\n", status);
			return -EINVAL;
		}
	}

	status = sl_si91x_fwup_load(ctx->flash_buffer + buf_offset,
				    ctx->flash_buffer_len - buf_offset);

	printf("Firmware load success for requested range=%d-%d\n", ctx->range_start,
	       ctx->range_start + ctx->flash_buffer_len - 1);

	/* Check if firmware update is completed */
	if (status == SL_STATUS_SI91X_FW_UPDATE_DONE) {
		printf("Firmware update completed. Rebooting...\n");
		sys_reboot(SYS_REBOOT_WARM);
	}
	if (status != SL_STATUS_OK) {
		return -EIO;
	}
	return 0;
}

/*
 * @brief Main OTA application state machine
 */
static int ota_application_start(struct app_ctx *ctx)
{
	int ret = 0;

	if (!ctx->connected) {
		k_event_clear(&ctx->events, WIFI_SCAN_DONE_EVENT | WIFI_SECURITY_TYPE_SET);
		ota_wifi_start_scan(ctx);

		ret = k_event_wait_safe(&ctx->events, WIFI_SCAN_DONE_EVENT | WIFI_SECURITY_TYPE_SET,
					false, K_SECONDS(10));
		if (ret == 0) {
			return -ETIMEDOUT;
		}

		ret = ota_wifi_connect(ctx);
		if (ret < 0) {
			ctx->security_type = WIFI_SECURITY_TYPE_PSK;
			return ret;
		}
	}

	if ((IS_ENABLED(CONFIG_NET_IPV4) && !ctx->ipv4_addr_config_done) ||
	    (IS_ENABLED(CONFIG_NET_IPV6) && !ctx->ipv6_addr_config_done)) {
		ret = ota_wait_for_ip_config(ctx);
		if (ret < 0) {
			return ret;
		}
	}

	if (ctx->sock < 0) {
		ret = ota_connect_to_server(ctx);
		if (ret < 0) {
			return ret;
		}
	}

	ret = ota_download_firmware_chunk(ctx);
	if (ret < 0) {
		goto out_close;
	}

	ret = ota_load_firmware(ctx);
	if (ret < 0) {
		goto out_reset;
	}
	ctx->range_start += sizeof(ctx->flash_buffer);
	return 0;

out_reset:
	ctx->range_start = 0;
out_close:
	zsock_close(ctx->sock);
	ctx->sock = -1;
	return ret;
}

int main(void)
{
	static struct app_ctx app_ctx = {
		.events = Z_EVENT_INITIALIZER(app_ctx.events),
		.sock = -1,
		.wifi_ssid = CONFIG_OTA_WIFI_SSID,
		.wifi_psk = CONFIG_OTA_WIFI_PSK,
		.security_type = WIFI_SECURITY_TYPE_PSK,
	};
	int retry_count = 0;
	int ret = 0;

	/* Register WiFi management callbacks */
	net_mgmt_init_event_callback(&app_ctx.mgmt_cb_wlan_scan_result, ota_handle_wifi_scan_result,
				     NET_EVENT_WIFI_SCAN_RESULT);
	net_mgmt_add_event_callback(&app_ctx.mgmt_cb_wlan_scan_result);

	net_mgmt_init_event_callback(&app_ctx.mgmt_cb_wlan_scan_done, ota_handle_wifi_scan_done,
				     NET_EVENT_WIFI_SCAN_DONE);
	net_mgmt_add_event_callback(&app_ctx.mgmt_cb_wlan_scan_done);

	net_mgmt_init_event_callback(&app_ctx.mgmt_cb_wlan_connect, ota_handle_wifi_connect_result,
				     NET_EVENT_WIFI_CONNECT_RESULT);
	net_mgmt_add_event_callback(&app_ctx.mgmt_cb_wlan_connect);

	net_mgmt_init_event_callback(&app_ctx.mgmt_cb_wlan_disconnect,
				     ota_handle_wifi_disconnect_result,
				     NET_EVENT_WIFI_DISCONNECT_RESULT);
	net_mgmt_add_event_callback(&app_ctx.mgmt_cb_wlan_disconnect);

	net_mgmt_init_event_callback(&app_ctx.mgmt_cb_ipv4, ota_ipv4_event_handler,
				     NET_EVENT_IPV4_ADDR_ADD | NET_EVENT_IPV4_ADDR_DEL);
	net_mgmt_add_event_callback(&app_ctx.mgmt_cb_ipv4);

	net_mgmt_init_event_callback(&app_ctx.mgmt_cb_ipv6, ota_ipv6_event_handler,
				     NET_EVENT_IPV6_ADDR_ADD | NET_EVENT_IPV6_ADDR_DEL);
	net_mgmt_add_event_callback(&app_ctx.mgmt_cb_ipv6);

	net_mgmt_init_event_callback(&app_ctx.mgmt_cb_dns, ota_dns_event_handler,
				     NET_EVENT_DNS_SERVER_ADD | NET_EVENT_DNS_SERVER_DEL);
	net_mgmt_add_event_callback(&app_ctx.mgmt_cb_dns);

	ota_parse_url(&app_ctx.url);
	if (IS_ENABLED(CONFIG_NET_DHCPV4)) {
		net_dhcpv4_start(net_if_get_first_wifi());
	}
	printf("OTA Application Started\n");
	while (retry_count < 3) {
		ret = ota_application_start(&app_ctx);
		if (ret < 0) {
			retry_count++;
			k_sleep(K_MSEC(1000));
		}
	}
	printf("Maximum retries exceeded, aborting OTA\n");
	return 0;
}
```

## src/ca-cert_der.c
```c
/*
 * Copyright (c) 2025 Silicon Laboratories Inc.
 *
 * SPDX-License-Identifier: Apache-2.0
 */

const unsigned char ca_cert_der[] = {
	0x30, 0x82, 0x04, 0xff, 0x30, 0x82, 0x03, 0xe7, 0xa0, 0x03, 0x02, 0x01, 0x02, 0x02, 0x14,
	0x6b, 0x9b, 0x70, 0xc6, 0xf1, 0xa3, 0x94, 0x65, 0x19, 0xa1, 0x08, 0x58, 0xef, 0xa7, 0x8d,
	0x2b, 0x7a, 0x83, 0xc1, 0xda, 0x30, 0x0d, 0x06, 0x09, 0x2a, 0x86, 0x48, 0x86, 0xf7, 0x0d,
	0x01, 0x01, 0x0b, 0x05, 0x00, 0x30, 0x81, 0x94, 0x31, 0x0b, 0x30, 0x09, 0x06, 0x03, 0x55,
	0x04, 0x06, 0x13, 0x02, 0x55, 0x53, 0x31, 0x10, 0x30, 0x0e, 0x06, 0x03, 0x55, 0x04, 0x08,
	0x0c, 0x07, 0x4d, 0x6f, 0x6e, 0x74, 0x61, 0x6e, 0x61, 0x31, 0x10, 0x30, 0x0e, 0x06, 0x03,
	0x55, 0x04, 0x07, 0x0c, 0x07, 0x42, 0x6f, 0x7a, 0x65, 0x6d, 0x61, 0x6e, 0x31, 0x11, 0x30,
	0x0f, 0x06, 0x03, 0x55, 0x04, 0x0a, 0x0c, 0x08, 0x53, 0x61, 0x77, 0x74, 0x6f, 0x6f, 0x74,
	0x68, 0x31, 0x13, 0x30, 0x11, 0x06, 0x03, 0x55, 0x04, 0x0b, 0x0c, 0x0a, 0x43, 0x6f, 0x6e,
	0x73, 0x75, 0x6c, 0x74, 0x69, 0x6e, 0x67, 0x31, 0x18, 0x30, 0x16, 0x06, 0x03, 0x55, 0x04,
	0x03, 0x0c, 0x0f, 0x77, 0x77, 0x77, 0x2e, 0x77, 0x6f, 0x6c, 0x66, 0x73, 0x73, 0x6c, 0x2e,
	0x63, 0x6f, 0x6d, 0x31, 0x1f, 0x30, 0x1d, 0x06, 0x09, 0x2a, 0x86, 0x48, 0x86, 0xf7, 0x0d,
	0x01, 0x09, 0x01, 0x16, 0x10, 0x69, 0x6e, 0x66, 0x6f, 0x40, 0x77, 0x6f, 0x6c, 0x66, 0x73,
	0x73, 0x6c, 0x2e, 0x63, 0x6f, 0x6d, 0x30, 0x1e, 0x17, 0x0d, 0x32, 0x34, 0x31, 0x32, 0x31,
	0x38, 0x32, 0x31, 0x32, 0x35, 0x32, 0x39, 0x5a, 0x17, 0x0d, 0x32, 0x37, 0x30, 0x39, 0x31,
	0x34, 0x32, 0x31, 0x32, 0x35, 0x32, 0x39, 0x5a, 0x30, 0x81, 0x94, 0x31, 0x0b, 0x30, 0x09,
	0x06, 0x03, 0x55, 0x04, 0x06, 0x13, 0x02, 0x55, 0x53, 0x31, 0x10, 0x30, 0x0e, 0x06, 0x03,
	0x55, 0x04, 0x08, 0x0c, 0x07, 0x4d, 0x6f, 0x6e, 0x74, 0x61, 0x6e, 0x61, 0x31, 0x10, 0x30,
	0x0e, 0x06, 0x03, 0x55, 0x04, 0x07, 0x0c, 0x07, 0x42, 0x6f, 0x7a, 0x65, 0x6d, 0x61, 0x6e,
	0x31, 0x11, 0x30, 0x0f, 0x06, 0x03, 0x55, 0x04, 0x0a, 0x0c, 0x08, 0x53, 0x61, 0x77, 0x74,
	0x6f, 0x6f, 0x74, 0x68, 0x31, 0x13, 0x30, 0x11, 0x06, 0x03, 0x55, 0x04, 0x0b, 0x0c, 0x0a,
	0x43, 0x6f, 0x6e, 0x73, 0x75, 0x6c, 0x74, 0x69, 0x6e, 0x67, 0x31, 0x18, 0x30, 0x16, 0x06,
	0x03, 0x55, 0x04, 0x03, 0x0c, 0x0f, 0x77, 0x77, 0x77, 0x2e, 0x77, 0x6f, 0x6c, 0x66, 0x73,
	0x73, 0x6c, 0x2e, 0x63, 0x6f, 0x6d, 0x31, 0x1f, 0x30, 0x1d, 0x06, 0x09, 0x2a, 0x86, 0x48,
	0x86, 0xf7, 0x0d, 0x01, 0x09, 0x01, 0x16, 0x10, 0x69, 0x6e, 0x66, 0x6f, 0x40, 0x77, 0x6f,
	0x6c, 0x66, 0x73, 0x73, 0x6c, 0x2e, 0x63, 0x6f, 0x6d, 0x30, 0x82, 0x01, 0x22, 0x30, 0x0d,
	0x06, 0x09, 0x2a, 0x86, 0x48, 0x86, 0xf7, 0x0d, 0x01, 0x01, 0x01, 0x05, 0x00, 0x03, 0x82,
	0x01, 0x0f, 0x00, 0x30, 0x82, 0x01, 0x0a, 0x02, 0x82, 0x01, 0x01, 0x00, 0xbf, 0x0c, 0xca,
	0x2d, 0x14, 0xb2, 0x1e, 0x84, 0x42, 0x5b, 0xcd, 0x38, 0x1f, 0x4a, 0xf2, 0x4d, 0x75, 0x10,
	0xf1, 0xb6, 0x35, 0x9f, 0xdf, 0xca, 0x7d, 0x03, 0x98, 0xd3, 0xac, 0xde, 0x03, 0x66, 0xee,
	0x2a, 0xf1, 0xd8, 0xb0, 0x7d, 0x6e, 0x07, 0x54, 0x0b, 0x10, 0x98, 0x21, 0x4d, 0x80, 0xcb,
	0x12, 0x20, 0xe7, 0xcc, 0x4f, 0xde, 0x45, 0x7d, 0xc9, 0x72, 0x77, 0x32, 0xea, 0xca, 0x90,
	0xbb, 0x69, 0x52, 0x10, 0x03, 0x2f, 0xa8, 0xf3, 0x95, 0xc5, 0xf1, 0x8b, 0x62, 0x56, 0x1b,
	0xef, 0x67, 0x6f, 0xa4, 0x10, 0x41, 0x95, 0xad, 0x0a, 0x9b, 0xe3, 0xa5, 0xc0, 0xb0, 0xd2,
	0x70, 0x76, 0x50, 0x30, 0x5b, 0xa8, 0xe8, 0x08, 0x2c, 0x7c, 0xed, 0xa7, 0xa2, 0x7a, 0x8d,
	0x38, 0x29, 0x1c, 0xac, 0xc7, 0xed, 0xf2, 0x7c, 0x95, 0xb0, 0x95, 0x82, 0x7d, 0x49, 0x5c,
	0x38, 0xcd, 0x77, 0x25, 0xef, 0xbd, 0x80, 0x75, 0x53, 0x94, 0x3c, 0x3d, 0xca, 0x63, 0x5b,
	0x9f, 0x15, 0xb5, 0xd3, 0x1d, 0x13, 0x2f, 0x19, 0xd1, 0x3c, 0xdb, 0x76, 0x3a, 0xcc, 0xb8,
	0x7d, 0xc9, 0xe5, 0xc2, 0xd7, 0xda, 0x40, 0x6f, 0xd8, 0x21, 0xdc, 0x73, 0x1b, 0x42, 0x2d,
	0x53, 0x9c, 0xfe, 0x1a, 0xfc, 0x7d, 0xab, 0x7a, 0x36, 0x3f, 0x98, 0xde, 0x84, 0x7c, 0x05,
	0x67, 0xce, 0x6a, 0x14, 0x38, 0x87, 0xa9, 0xf1, 0x8c, 0xb5, 0x68, 0xcb, 0x68, 0x7f, 0x71,
	0x20, 0x2b, 0xf5, 0xa0, 0x63, 0xf5, 0x56, 0x2f, 0xa3, 0x26, 0xd2, 0xb7, 0x6f, 0xb1, 0x5a,
	0x17, 0xd7, 0x38, 0x99, 0x08, 0xfe, 0x93, 0x58, 0x6f, 0xfe, 0xc3, 0x13, 0x49, 0x08, 0x16,
	0x0b, 0xa7, 0x4d, 0x67, 0x00, 0x52, 0x31, 0x67, 0x23, 0x4e, 0x98, 0xed, 0x51, 0x45, 0x1d,
	0xb9, 0x04, 0xd9, 0x0b, 0xec, 0xd8, 0x28, 0xb3, 0x4b, 0xbd, 0xed, 0x36, 0x79, 0x02, 0x03,
	0x01, 0x00, 0x01, 0xa3, 0x82, 0x01, 0x45, 0x30, 0x82, 0x01, 0x41, 0x30, 0x1d, 0x06, 0x03,
	0x55, 0x1d, 0x0e, 0x04, 0x16, 0x04, 0x14, 0x27, 0x8e, 0x67, 0x11, 0x74, 0xc3, 0x26, 0x1d,
	0x3f, 0xed, 0x33, 0x63, 0xb3, 0xa4, 0xd8, 0x1d, 0x30, 0xe5, 0xe8, 0xd5, 0x30, 0x81, 0xd4,
	0x06, 0x03, 0x55, 0x1d, 0x23, 0x04, 0x81, 0xcc, 0x30, 0x81, 0xc9, 0x80, 0x14, 0x27, 0x8e,
	0x67, 0x11, 0x74, 0xc3, 0x26, 0x1d, 0x3f, 0xed, 0x33, 0x63, 0xb3, 0xa4, 0xd8, 0x1d, 0x30,
	0xe5, 0xe8, 0xd5, 0xa1, 0x81, 0x9a, 0xa4, 0x81, 0x97, 0x30, 0x81, 0x94, 0x31, 0x0b, 0x30,
	0x09, 0x06, 0x03, 0x55, 0x04, 0x06, 0x13, 0x02, 0x55, 0x53, 0x31, 0x10, 0x30, 0x0e, 0x06,
	0x03, 0x55, 0x04, 0x08, 0x0c, 0x07, 0x4d, 0x6f, 0x6e, 0x74, 0x61, 0x6e, 0x61, 0x31, 0x10,
	0x30, 0x0e, 0x06, 0x03, 0x55, 0x04, 0x07, 0x0c, 0x07, 0x42, 0x6f, 0x7a, 0x65, 0x6d, 0x61,
	0x6e, 0x31, 0x11, 0x30, 0x0f, 0x06, 0x03, 0x55, 0x04, 0x0a, 0x0c, 0x08, 0x53, 0x61, 0x77,
	0x74, 0x6f, 0x6f, 0x74, 0x68, 0x31, 0x13, 0x30, 0x11, 0x06, 0x03, 0x55, 0x04, 0x0b, 0x0c,
	0x0a, 0x43, 0x6f, 0x6e, 0x73, 0x75, 0x6c, 0x74, 0x69, 0x6e, 0x67, 0x31, 0x18, 0x30, 0x16,
	0x06, 0x03, 0x55, 0x04, 0x03, 0x0c, 0x0f, 0x77, 0x77, 0x77, 0x2e, 0x77, 0x6f, 0x6c, 0x66,
	0x73, 0x73, 0x6c, 0x2e, 0x63, 0x6f, 0x6d, 0x31, 0x1f, 0x30, 0x1d, 0x06, 0x09, 0x2a, 0x86,
	0x48, 0x86, 0xf7, 0x0d, 0x01, 0x09, 0x01, 0x16, 0x10, 0x69, 0x6e, 0x66, 0x6f, 0x40, 0x77,
	0x6f, 0x6c, 0x66, 0x73, 0x73, 0x6c, 0x2e, 0x63, 0x6f, 0x6d, 0x82, 0x14, 0x6b, 0x9b, 0x70,
	0xc6, 0xf1, 0xa3, 0x94, 0x65, 0x19, 0xa1, 0x08, 0x58, 0xef, 0xa7, 0x8d, 0x2b, 0x7a, 0x83,
	0xc1, 0xda, 0x30, 0x0c, 0x06, 0x03, 0x55, 0x1d, 0x13, 0x04, 0x05, 0x30, 0x03, 0x01, 0x01,
	0xff, 0x30, 0x1c, 0x06, 0x03, 0x55, 0x1d, 0x11, 0x04, 0x15, 0x30, 0x13, 0x82, 0x0b, 0x65,
	0x78, 0x61, 0x6d, 0x70, 0x6c, 0x65, 0x2e, 0x63, 0x6f, 0x6d, 0x87, 0x04, 0x7f, 0x00, 0x00,
	0x01, 0x30, 0x1d, 0x06, 0x03, 0x55, 0x1d, 0x25, 0x04, 0x16, 0x30, 0x14, 0x06, 0x08, 0x2b,
	0x06, 0x01, 0x05, 0x05, 0x07, 0x03, 0x01, 0x06, 0x08, 0x2b, 0x06, 0x01, 0x05, 0x05, 0x07,
	0x03, 0x02, 0x30, 0x0d, 0x06, 0x09, 0x2a, 0x86, 0x48, 0x86, 0xf7, 0x0d, 0x01, 0x01, 0x0b,
	0x05, 0x00, 0x03, 0x82, 0x01, 0x01, 0x00, 0x77, 0x3b, 0x3d, 0x66, 0x74, 0xbc, 0x97, 0xfe,
	0x40, 0x16, 0xe6, 0xba, 0xa5, 0xd5, 0xd1, 0x84, 0x08, 0x89, 0x69, 0x4f, 0x88, 0x0d, 0x57,
	0xa9, 0xef, 0x8c, 0xc3, 0x97, 0x52, 0xc8, 0xbd, 0x8b, 0xa2, 0x49, 0x3b, 0xb7, 0xf7, 0x5d,
	0x1e, 0xd6, 0x14, 0x7f, 0xb2, 0x80, 0x33, 0xda, 0xa0, 0x8a, 0xd3, 0xe1, 0x2f, 0xd5, 0xbc,
	0x33, 0x9f, 0xea, 0x5a, 0x72, 0x24, 0xe5, 0xf8, 0xb8, 0x4b, 0xb3, 0xdf, 0x62, 0x90, 0x3b,
	0xa8, 0x21, 0xef, 0x27, 0x42, 0x75, 0xbc, 0x60, 0x02, 0x8e, 0x37, 0x35, 0x99, 0xeb, 0xa3,
	0x28, 0xf2, 0x65, 0x4c, 0xff, 0x7a, 0xf8, 0x8e, 0xcc, 0x23, 0x6d, 0xe5, 0x6a, 0xfe, 0x22,
	0x5a, 0xd9, 0xb2, 0x4f, 0x47, 0xc7, 0xe0, 0xae, 0x98, 0xef, 0x94, 0xac, 0xb6, 0x4f, 0x61,
	0x81, 0x29, 0x8e, 0xe1, 0x79, 0x2c, 0x46, 0xfc, 0xe9, 0x1a, 0xc3, 0x96, 0x1f, 0x19, 0x93,
	0x64, 0x2e, 0x9f, 0x37, 0x72, 0xc5, 0xe4, 0x93, 0x4e, 0x61, 0x5f, 0x38, 0x8e, 0xae, 0xe8,
	0x39, 0x19, 0xe6, 0x97, 0xa8, 0x91, 0xd4, 0x23, 0x7e, 0x1e, 0xd2, 0xd0, 0x53, 0xec, 0xcc,
	0xac, 0xa0, 0x1d, 0xd0, 0xb7, 0xdd, 0xb1, 0xb7, 0x01, 0x2e, 0x96, 0xcd, 0x85, 0x27, 0xe0,
	0xe7, 0x47, 0xe2, 0xc1, 0xc1, 0x00, 0xf6, 0x94, 0xdf, 0x77, 0xe7, 0xfa, 0xc6, 0xef, 0x8a,
	0xc0, 0x7c, 0x67, 0xbc, 0xff, 0xa0, 0x7c, 0x94, 0x3b, 0x7d, 0x86, 0x42, 0xaf, 0x3d, 0x83,
	0x31, 0xee, 0x2a, 0x3b, 0x7b, 0xf0, 0x2c, 0x9e, 0x6f, 0xe9, 0xc4, 0x07, 0x81, 0x24, 0xda,
	0x05, 0x70, 0x4d, 0xdd, 0x09, 0xae, 0x9e, 0x72, 0xb8, 0x21, 0x0e, 0x8c, 0xb2, 0xab, 0xaa,
	0x4c, 0x49, 0x10, 0xf7, 0x76, 0xf9, 0xb5, 0x0d, 0x6c, 0x20, 0xd3, 0xdf, 0x7a, 0x06, 0x32,
	0x8d, 0x29, 0x1f, 0x28, 0x1d, 0x8d, 0x26, 0x33};
unsigned int ca_cert_der_len = 1283;
```
