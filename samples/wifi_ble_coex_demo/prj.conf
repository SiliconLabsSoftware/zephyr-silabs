## CMakeLists.txt
```
# SPDX-License-Identifier: Apache-2.0

cmake_minimum_required(VERSION 3.20.0)

find_package(Zephyr REQUIRED HINTS $ENV{ZEPHYR_BASE})
project(wifi_ble_coex_throughput)

target_sources(app PRIVATE src/main.c)
```

## prj.conf
```kconfig
CONFIG_NETWORKING=y
CONFIG_WIFI=y
CONFIG_NET_MGMT=y
CONFIG_WIFI_SILABS_SIWX91X_NET_STACK_NATIVE=y
CONFIG_NET_IPV4=y
CONFIG_NET_ARP=y
CONFIG_NET_DHCPV4=y
CONFIG_INIT_STACKS=y
CONFIG_NET_MGMT_EVENT=y
CONFIG_NET_TCP=y

CONFIG_REQUIRES_FULL_LIBC=y
CONFIG_NET_SOCKETS=y
CONFIG_POSIX_API=y
CONFIG_HEAP_MEM_POOL_SIZE=8192
CONFIG_THREAD_NAME=y
CONFIG_NET_BUF_POOL_USAGE=y

CONFIG_BT=y
CONFIG_LOG=y
CONFIG_PRINTK=y
CONFIG_BT_PERIPHERAL=y
CONFIG_BT_DEVICE_NAME="BLE_WIFI_COEX"
CONFIG_BT_DEVICE_APPEARANCE=833
CONFIG_BT_L2CAP_TX_MTU=247
CONFIG_BT_BUF_ACL_RX_SIZE=255
CONFIG_BT_BUF_ACL_TX_SIZE=251
CONFIG_BT_BUF_CMD_TX_SIZE=255
CONFIG_BT_BUF_EVT_DISCARDABLE_SIZE=255
CONFIG_BT_GATT_CLIENT=y

CONFIG_SYSTEM_WORKQUEUE_STACK_SIZE=4096
CONFIG_MAIN_STACK_SIZE=4096
```

## src/app_config.h
```c
typedef enum wlan_app_state_e {
	WLAN_SCAN_STATE = 0,
	WLAN_NET_UP_STATE,
	WLAN_IP_CONFIG_STATE,
	WLAN_SOCKET_CREATE_STATE,
	WLAN_SEND_SOCKET_DATA_STATE,
	WLAN_SOCKET_CLOSE_STATE,
} wlan_app_state_t;

#define CMD_WAIT_TIME 180000
#define STACK_SIZE    2048
#define SUCCESS       0
#define STACK_SIZE_BT 2048 /*BT stack size*/

#define WIFI_SHELL_MGMT_EVENTS_COMMON                                                              \
	(NET_EVENT_WIFI_SCAN_DONE | NET_EVENT_WIFI_CONNECT_RESULT |                                \
	 NET_EVENT_WIFI_DISCONNECT_RESULT | NET_EVENT_WIFI_TWT | NET_EVENT_WIFI_RAW_SCAN_RESULT |  \
	 NET_EVENT_WIFI_AP_ENABLE_RESULT | NET_EVENT_WIFI_AP_DISABLE_RESULT |                      \
	 NET_EVENT_WIFI_AP_STA_CONNECTED | NET_EVENT_WIFI_AP_STA_DISCONNECTED)

#ifdef CONFIG_WIFI_MGMT_RAW_SCAN_RESULTS_ONLY
#define WIFI_SHELL_MGMT_EVENTS (WIFI_SHELL_MGMT_EVENTS_COMMON)
#else
#define WIFI_SHELL_MGMT_EVENTS (WIFI_SHELL_MGMT_EVENTS_COMMON | NET_EVENT_WIFI_SCAN_RESULT)
#endif /* CONFIG_WIFI_MGMT_RAW_SCAN_RESULTS_ONLY */
#define L4_EVENT_MASK (NET_EVENT_L4_IPV6_CONNECTED)

void application_start(void);
static void start_dhcpv4_client(struct net_if *iface, void *user_data);
static void wifi_mgmt_event_handler(struct net_mgmt_event_callback *cb, uint64_t mgmt_event,
				    struct net_if *iface);
```
