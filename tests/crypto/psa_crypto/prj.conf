## CMakeLists.txt
```
# SPDX-License-Identifier: Apache-2.0
# Copyright (c) 2025 Silicon Laboratories Inc.

cmake_minimum_required(VERSION 3.20.0)

find_package(Zephyr REQUIRED HINTS $ENV{ZEPHYR_BASE})
project(psa_crypto)

target_sources(app PRIVATE
  src/main.c
  src/test_vectors.c
  src/aead.c
  src/cipher.c
  src/hash.c
  src/mac.c
  src/sign.c
  src/key_agreement.c
)

# Use CMake variables to configure testcase, since Kconfig can't be defined
# in out-of-tree tests due to the compliance script failing.

# HSE fully supports opaque keys and multipart operations
dt_nodelabel(se_path NODELABEL "se")
if(CONFIG_SILABS_SISDK_PSA_CRYPTO AND DEFINED se_path)
  target_compile_definitions(app PUBLIC
    TEST_OPAQUE_AEAD=1
    TEST_OPAQUE_CIPHER=1
    TEST_OPAQUE_KEY_AGREEMENT=1
    TEST_OPAQUE_SIGN=1
  )
  # SixG301 does not hardware accelerate ChaCha20, so opaque keys can't be used
  if(CONFIG_SOC_FAMILY_SILABS_S3_SIX301)
    target_compile_definitions(app PUBLIC
      TEST_OPAQUE_NO_CHACHA=1
    )
  endif()
endif()

# SiWx917 only supports one-shot operations on internally generated opaque keys
# for sign_message/verify_message and AEAD encrypt/decrypt
if(CONFIG_PSA_CRYPTO_DRIVER_SILABS_SIWX91X)
target_compile_definitions(app PUBLIC
  TEST_OPAQUE_AEAD=1
  # Disable opaque signing test while hardware acceleration is disabled
  # TEST_OPAQUE_SIGN=1
  TEST_OPAQUE_NO_IMPORT_KEY=1
  TEST_OPAQUE_NO_MULTIPART=1
  TEST_OPAQUE_NO_VERIFY=1
)
endif()
```

## prj.conf
```kconfig
CONFIG_ZTEST=y
CONFIG_PSA_CRYPTO=y
CONFIG_ENTROPY_GENERATOR=y

# Enable AES ECB, CBC, CCM, GCM
CONFIG_PSA_WANT_KEY_TYPE_AES=y
CONFIG_PSA_WANT_ALG_ECB_NO_PADDING=y
CONFIG_PSA_WANT_ALG_CBC_NO_PADDING=y
CONFIG_PSA_WANT_ALG_CCM=y
CONFIG_PSA_WANT_ALG_GCM=y

# Enable ChaCha20-Poly1305
CONFIG_PSA_WANT_KEY_TYPE_CHACHA20=y
CONFIG_PSA_WANT_ALG_STREAM_CIPHER=y
CONFIG_PSA_WANT_ALG_CHACHA20_POLY1305=y

# Enable ECDSA P-256
CONFIG_PSA_WANT_KEY_TYPE_ECC_KEY_PAIR_GENERATE=y
CONFIG_PSA_WANT_ALG_ECDSA=y
CONFIG_PSA_WANT_ECC_SECP_R1_256=y

# Enable SHA-256
CONFIG_PSA_WANT_ALG_SHA_256=y
CONFIG_PSA_WANT_ALG_SHA_384=y
CONFIG_PSA_WANT_ALG_SHA_512=y

# Enable ECDH Curve25519
CONFIG_PSA_WANT_KEY_TYPE_ECC_KEY_PAIR_IMPORT=y
CONFIG_PSA_WANT_ALG_ECDH=y
CONFIG_PSA_WANT_ECC_MONTGOMERY_255=y

# Enable MAC
CONFIG_PSA_WANT_ALG_HMAC=y
CONFIG_PSA_WANT_ALG_CMAC=y
```

## host_crypto.overlay
```dts
/*
 * Copyright (c) 2026 Silicon Laboratories Inc.
 * SPDX-License-Identifier: Apache-2.0
 */

&symcrypto {
	status = "okay";
};
```

## src/main.c
```c
/*
 * Copyright (c) 2024 Silicon Laboratories Inc.
 *
 * SPDX-License-Identifier: Apache-2.0
 */

#include <zephyr/ztest.h>
#include <psa/crypto.h>

static void *psa_crypto_setup(void)
{
	return NULL;
}

ZTEST_SUITE(psa_crypto_test, NULL, psa_crypto_setup, NULL, NULL, NULL);
```

## src/aead.c
```c
/*
 * Copyright (c) 2025 Silicon Laboratories Inc.
 *
 * SPDX-License-Identifier: Apache-2.0
 */

#include <zephyr/ztest.h>
#include <psa/crypto.h>

#include "test_vectors.h"

static const uint8_t aes_key_buf[] = {0xea, 0x4f, 0x6f, 0x3c, 0x2f, 0xed, 0x2b, 0x9d,
				      0xd9, 0x70, 0x8c, 0x2e, 0x72, 0x1a, 0xe0, 0x0f};
static const uint8_t aes_nonce_buf[] = {0xf9, 0x75, 0x80, 0x9d, 0xdb, 0x51,
					0x72, 0x38, 0x27, 0x45, 0x63, 0x4f};
static const uint8_t aes_ad_buf[] = {0x5c, 0x65, 0xd4, 0xf2, 0x61, 0xd2, 0xc5, 0x4f, 0xfe, 0x6a};
static const uint8_t aes_plaintext[] = {0x8d, 0x6c, 0x08, 0x44, 0x6c, 0xb1, 0x0d, 0x9a, 0x20, 0x75};

static const uint8_t chachapoly_key_buf[] = {0x80, 0x81, 0x82, 0x83, 0x84, 0x85, 0x86, 0x87,
					     0x88, 0x89, 0x8a, 0x8b, 0x8c, 0x8d, 0x8e, 0x8f,
					     0x90, 0x91, 0x92, 0x93, 0x94, 0x95, 0x96, 0x97,
					     0x98, 0x99, 0x9a, 0x9b, 0x9c, 0x9d, 0x9e, 0x9f};
static const uint8_t chachapoly_nonce_buf[] = {0x07, 0x00, 0x00, 0x00, 0x40, 0x41,
					       0x42, 0x43, 0x44, 0x45, 0x46, 0x47};
static const uint8_t chachapoly_ad_buf[] = {0x50, 0x51, 0x52, 0x53, 0xc0, 0xc1,
					    0xc2, 0xc3, 0xc4, 0xc5, 0xc6, 0xc7};
static const uint8_t chachapoly_plaintext[] = {
	0x4c, 0x61, 0x64, 0x69, 0x65, 0x73, 0x20, 0x61, 0x6e, 0x64, 0x20, 0x47, 0x65, 0x6e, 0x74,
	0x6c, 0x65, 0x6d, 0x65, 0x6e, 0x20, 0x6f, 0x66, 0x20, 0x74, 0x68, 0x65, 0x20, 0x63, 0x6c,
	0x61, 0x73, 0x73, 0x20, 0x6f, 0x66, 0x20, 0x27, 0x39, 0x39, 0x3a, 0x20, 0x49, 0x66, 0x20,
	0x49, 0x20, 0x63, 0x6f, 0x75, 0x6c, 0x64, 0x20, 0x6f, 0x66, 0x66, 0x65, 0x72, 0x20, 0x79,
	0x6f, 0x75, 0x20, 0x6f, 0x6e, 0x6c, 0x79, 0x20, 0x6f, 0x6e, 0x65, 0x20, 0x74, 0x69, 0x70,
	0x20, 0x66, 0x6f, 0x72, 0x20, 0x74, 0x68, 0x65, 0x20, 0x66, 0x75, 0x74, 0x75, 0x72, 0x65,
	0x2c, 0x20, 0x73, 0x75, 0x6e, 0x73, 0x63, 0x72, 0x65, 0x65, 0x6e, 0x20, 0x77, 0x6f, 0x75,
	0x6c, 0x64, 0x20, 0x62, 0x65, 0x20, 0x69, 0x74, 0x2e};
static const uint8_t chachapoly_expect_cipher_tag_buf[] = {
	0xd3, 0x1a, 0x8d, 0x34, 0x64, 0x8e, 0x60, 0xdb, 0x7b, 0x86, 0xaf, 0xbc, 0x53, 0xef, 0x7e,
	0xc2, 0xa4, 0xad, 0xed, 0x51, 0x29, 0x6e, 0x08, 0xfe, 0xa9, 0xe2, 0xb5, 0xa7, 0x36, 0xee,
	0x62, 0xd6, 0x3d, 0xbe, 0xa4, 0x5e, 0x8c, 0xa9, 0x67, 0x12, 0x82, 0xfa, 0xfb, 0x69, 0xda,
	0x92, 0x72, 0x8b, 0x1a, 0x71, 0xde, 0x0a, 0x9e, 0x06, 0x0b, 0x29, 0x05, 0xd6, 0xa5, 0xb6,
	0x7e, 0xcd, 0x3b, 0x36, 0x92, 0xdd, 0xbd, 0x7f, 0x2d, 0x77, 0x8b, 0x8c, 0x98, 0x03, 0xae,
	0xe3, 0x28, 0x09, 0x1b, 0x58, 0xfa, 0xb3, 0x24, 0xe4, 0xfa, 0xd6, 0x75, 0x94, 0x55, 0x85,
	0x80, 0x8b, 0x48, 0x31, 0xd7, 0xbc, 0x3f, 0xf4, 0xde, 0xf0, 0x8e, 0x4b, 0x7a, 0x9d, 0xe5,
	0x76, 0xd2, 0x65, 0x86, 0xce, 0xc6, 0x4b, 0x61, 0x16, 0x1a, 0xe1, 0x0b, 0x59, 0x4f, 0x09,
	0xe2, 0x6a, 0x7e, 0x90, 0x2e, 0xcb, 0xd0, 0x60, 0x06, 0x91,
};
static uint8_t long_cipher_tag_buf[sizeof(long_plaintext) + 16];
static uint8_t long_decrypted[sizeof(long_plaintext)];

void test_aead_aes_ccm(bool generate_key, psa_key_location_t location)
{
	const uint8_t expect_cipher_tag_buf[] = {
		0xe2, 0x2f, 0x37, 0x3b, 0xeb, 0xf6, 0x4a, 0x3e, 0x9b, 0x87, 0x75, 0x2b, 0xf9,
		0xdb, 0x34, 0xdc, 0x4d, 0x43, 0x3f, 0x00, 0xf5, 0x5c, 0x3f, 0x53, 0x0c, 0x89,
	};
	uint8_t cipher_tag_buf[32] = {0};
	uint8_t decrypted[sizeof(aes_plaintext)] = {0};
	size_t enc_len, out_len;

	psa_key_id_t key_id;
	psa_key_attributes_t attributes = PSA_KEY_ATTRIBUTES_INIT;
	psa_algorithm_t alg = PSA_ALG_CCM;

	psa_set_key_type(&attributes, PSA_KEY_TYPE_AES);
	psa_set_key_usage_flags(&attributes, PSA_KEY_USAGE_ENCRYPT | PSA_KEY_USAGE_DECRYPT);
	psa_set_key_algorithm(&attributes, alg);
	psa_set_key_bits(&attributes, 128);
	psa_set_key_lifetime(&attributes, PSA_KEY_LIFETIME_FROM_PERSISTENCE_AND_LOCATION(
						  PSA_KEY_PERSISTENCE_VOLATILE, location));

	if (generate_key) {
		zassert_equal(psa_generate_key(&attributes, &key_id), PSA_SUCCESS,
			      "Failed to generate key");
	} else {
		zassert_equal(
			psa_import_key(&attributes, aes_key_buf, sizeof(aes_key_buf), &key_id),
			PSA_SUCCESS, "Failed to import key");
	}

	zassert_equal(psa_aead_encrypt(key_id, alg, aes_nonce_buf, sizeof(aes_nonce_buf),
				       aes_ad_buf, sizeof(aes_ad_buf), aes_plaintext,
				       sizeof(aes_plaintext), cipher_tag_buf,
				       sizeof(cipher_tag_buf), &enc_len),
		      PSA_SUCCESS, "Failed to encrypt");

	zassert_equal(enc_len, sizeof(expect_cipher_tag_buf));
	if (!generate_key) {
		zassert_mem_equal(cipher_tag_buf, expect_cipher_tag_buf,
				  sizeof(expect_cipher_tag_buf));
	}

	zassert_equal(psa_aead_decrypt(key_id, alg, aes_nonce_buf, sizeof(aes_nonce_buf),
				       aes_ad_buf, sizeof(aes_ad_buf), cipher_tag_buf, enc_len,
				       decrypted, sizeof(decrypted), &out_len),
		      PSA_SUCCESS, "Failed to decrypt");

	zassert_equal(out_len, sizeof(aes_plaintext));
	zassert_mem_equal(decrypted, aes_plaintext, sizeof(aes_plaintext));

	memset(&cipher_tag_buf[sizeof(aes_plaintext)], 0, 16);
	zassert_equal(psa_aead_decrypt(key_id, alg, aes_nonce_buf, sizeof(aes_nonce_buf),
				       aes_ad_buf, sizeof(aes_ad_buf), cipher_tag_buf, enc_len,
				       decrypted, sizeof(decrypted), &out_len),
		      PSA_ERROR_INVALID_SIGNATURE, "Decrypt succeeded despite bad tag");

	zassert_equal(psa_destroy_key(key_id), PSA_SUCCESS, "Failed to destroy key");
}

void test_aead_aes_ccm_long(bool generate_key, psa_key_location_t location)
{
	size_t out_len;

	psa_key_id_t key_id;
	psa_key_attributes_t attributes = PSA_KEY_ATTRIBUTES_INIT;
	psa_algorithm_t alg = PSA_ALG_CCM;

	psa_set_key_type(&attributes, PSA_KEY_TYPE_AES);
	psa_set_key_usage_flags(&attributes, PSA_KEY_USAGE_ENCRYPT | PSA_KEY_USAGE_DECRYPT);
	psa_set_key_algorithm(&attributes, alg);
	psa_set_key_bits(&attributes, 128);
	psa_set_key_lifetime(&attributes, PSA_KEY_LIFETIME_FROM_PERSISTENCE_AND_LOCATION(
						  PSA_KEY_PERSISTENCE_VOLATILE, location));

	if (generate_key) {
		zassert_equal(psa_generate_key(&attributes, &key_id), PSA_SUCCESS,
			      "Failed to generate key");
	} else {
		zassert_equal(
			psa_import_key(&attributes, aes_key_buf, sizeof(aes_key_buf), &key_id),
			PSA_SUCCESS, "Failed to import key");
	}

	zassert_equal(psa_aead_encrypt(key_id, alg, aes_nonce_buf, sizeof(aes_nonce_buf),
				       aes_ad_buf, sizeof(aes_ad_buf), long_plaintext,
				       sizeof(long_plaintext), long_cipher_tag_buf,
				       sizeof(long_cipher_tag_buf), &out_len),
		      PSA_SUCCESS, "Failed to encrypt");

	zassert_equal(out_len, sizeof(long_cipher_tag_buf));

	zassert_equal(psa_aead_decrypt(key_id, alg, aes_nonce_buf, sizeof(aes_nonce_buf),
				       aes_ad_buf, sizeof(aes_ad_buf), long_cipher_tag_buf, out_len,
				       long_decrypted, sizeof(long_decrypted), &out_len),
		      PSA_SUCCESS, "Failed to decrypt");

	zassert_equal(out_len, sizeof(long_plaintext));
	zassert_mem_equal(long_decrypted, long_plaintext, sizeof(long_plaintext));

	zassert_equal(psa_destroy_key(key_id), PSA_SUCCESS, "Failed to destroy key");
}

void test_aead_aes_gcm(bool generate_key, psa_key_location_t location)
{
	const uint8_t expect_cipher_tag_buf[] = {
		0x0f, 0x51, 0xf7, 0xa8, 0x3c, 0x5b, 0x5a, 0xa7, 0x96, 0xb9, 0x70, 0x25, 0x9c,
		0xdd, 0xfe, 0x8f, 0x9a, 0x15, 0xa5, 0xc5, 0xeb, 0x48, 0x5a, 0xf5, 0x78, 0xfb,
	};
	uint8_t cipher_tag_buf[32];
	uint8_t decrypted[sizeof(aes_plaintext)] = {0};
	size_t enc_len, out_len;

	psa_key_id_t key_id;
	psa_key_attributes_t attributes = PSA_KEY_ATTRIBUTES_INIT;
	psa_algorithm_t alg = PSA_ALG_GCM;

	psa_set_key_type(&attributes, PSA_KEY_TYPE_AES);
	psa_set_key_usage_flags(&attributes, PSA_KEY_USAGE_ENCRYPT | PSA_KEY_USAGE_DECRYPT);
	psa_set_key_algorithm(&attributes, alg);
	psa_set_key_bits(&attributes, 128);
	psa_set_key_lifetime(&attributes, PSA_KEY_LIFETIME_FROM_PERSISTENCE_AND_LOCATION(
						  PSA_KEY_PERSISTENCE_VOLATILE, location));

	if (generate_key) {
		zassert_equal(psa_generate_key(&attributes, &key_id), PSA_SUCCESS,
			      "Failed to generate key");
	} else {
		zassert_equal(
			psa_import_key(&attributes, aes_key_buf, sizeof(aes_key_buf), &key_id),
			PSA_SUCCESS, "Failed to import key");
	}

	zassert_equal(psa_aead_encrypt(key_id, alg, aes_nonce_buf, sizeof(aes_nonce_buf),
				       aes_ad_buf, sizeof(aes_ad_buf), aes_plaintext,
				       sizeof(aes_plaintext), cipher_tag_buf,
				       sizeof(cipher_tag_buf), &enc_len),
		      PSA_SUCCESS, "Failed to encrypt");

	zassert_equal(enc_len, sizeof(expect_cipher_tag_buf));
	if (!generate_key) {
		size_t i = 0;

		for (i = 0; i < sizeof(expect_cipher_tag_buf); i++) {
			if (cipher_tag_buf[i] != expect_cipher_tag_buf[i]) {
				break;
			}
		}
		zassert_mem_equal(cipher_tag_buf, expect_cipher_tag_buf,
				  sizeof(expect_cipher_tag_buf), "First mismatch at offset %d/%d",
				  i, sizeof(expect_cipher_tag_buf));
	}

	zassert_equal(psa_aead_decrypt(key_id, alg, aes_nonce_buf, sizeof(aes_nonce_buf),
				       aes_ad_buf, sizeof(aes_ad_buf), cipher_tag_buf, enc_len,
				       decrypted, sizeof(decrypted), &out_len),
		      PSA_SUCCESS, "Failed to decrypt");

	zassert_equal(out_len, sizeof(aes_plaintext));
	zassert_mem_equal(decrypted, aes_plaintext, sizeof(aes_plaintext));

	memset(&cipher_tag_buf[sizeof(aes_plaintext)], 0, 16);
	zassert_equal(psa_aead_decrypt(key_id, alg, aes_nonce_buf, sizeof(aes_nonce_buf),
				       aes_ad_buf, sizeof(aes_ad_buf), cipher_tag_buf, enc_len,
				       decrypted, sizeof(decrypted), &out_len),
		      PSA_ERROR_INVALID_SIGNATURE, "Decrypt succeeded despite bad tag");

	zassert_equal(psa_destroy_key(key_id), PSA_SUCCESS, "Failed to destroy key");
}

void test_aead_aes_gcm_long(bool generate_key, psa_key_location_t location)
{
	size_t out_len;

	psa_key_id_t key_id;
	psa_key_attributes_t attributes = PSA_KEY_ATTRIBUTES_INIT;
	psa_algorithm_t alg = PSA_ALG_GCM;

	psa_set_key_type(&attributes, PSA_KEY_TYPE_AES);
	psa_set_key_usage_flags(&attributes, PSA_KEY_USAGE_ENCRYPT | PSA_KEY_USAGE_DECRYPT);
	psa_set_key_algorithm(&attributes, alg);
	psa_set_key_bits(&attributes, 128);
	psa_set_key_lifetime(&attributes, PSA_KEY_LIFETIME_FROM_PERSISTENCE_AND_LOCATION(
						  PSA_KEY_PERSISTENCE_VOLATILE, location));

	if (generate_key) {
		zassert_equal(psa_generate_key(&attributes, &key_id), PSA_SUCCESS,
			      "Failed to generate key");
	} else {
		zassert_equal(
			psa_import_key(&attributes, aes_key_buf, sizeof(aes_key_buf), &key_id),
			PSA_SUCCESS, "Failed to import key");
	}

	zassert_equal(psa_aead_encrypt(key_id, alg, aes_nonce_buf, sizeof(aes_nonce_buf),
				       aes_ad_buf, sizeof(aes_ad_buf), long_plaintext,
				       sizeof(long_plaintext), long_cipher_tag_buf,
				       sizeof(long_cipher_tag_buf), &out_len),
		      PSA_SUCCESS, "Failed to encrypt");

	zassert_equal(out_len, sizeof(long_cipher_tag_buf));

	zassert_equal(psa_aead_decrypt(key_id, alg, aes_nonce_buf, sizeof(aes_nonce_buf),
				       aes_ad_buf, sizeof(aes_ad_buf), long_cipher_tag_buf, out_len,
				       long_decrypted, sizeof(long_decrypted), &out_len),
		      PSA_SUCCESS, "Failed to decrypt");

	zassert_equal(out_len, sizeof(long_plaintext));

	size_t i = 0;

	for (i = 0; i < sizeof(long_plaintext); i++) {
		if (long_decrypted[i] != long_plaintext[i]) {
			break;
		}
	}
	zassert_mem_equal(long_decrypted, long_plaintext, sizeof(long_plaintext),
			  "First mismatch at offset %d/%d", i, sizeof(long_plaintext));

	zassert_equal(psa_destroy_key(key_id), PSA_SUCCESS, "Failed to destroy key");
}

void test_aead_chacha20_poly1305(bool generate_key, psa_key_location_t location)
{
	uint8_t cipher_tag_buf[130]; /* Ciphertext + Tag */
	uint8_t decrypted[sizeof(chachapoly_plaintext)] = {0};
	size_t enc_len, out_len;

	psa_key_id_t key_id;
	psa_key_attributes_t attributes = PSA_KEY_ATTRIBUTES_INIT;
	psa_algorithm_t alg = PSA_ALG_CHACHA20_POLY1305;

	psa_set_key_usage_flags(&attributes, PSA_KEY_USAGE_ENCRYPT | PSA_KEY_USAGE_DECRYPT);
	psa_set_key_algorithm(&attributes, alg);
	psa_set_key_type(&attributes, PSA_KEY_TYPE_CHACHA20);
	psa_set_key_bits(&attributes, 256);
	psa_set_key_lifetime(&attributes, PSA_KEY_LIFETIME_FROM_PERSISTENCE_AND_LOCATION(
						  PSA_KEY_PERSISTENCE_VOLATILE, location));

	if (generate_key) {
		zassert_equal(psa_generate_key(&attributes, &key_id), PSA_SUCCESS,
			      "Failed to generate key");
	} else {
		zassert_equal(psa_import_key(&attributes, chachapoly_key_buf,
					     sizeof(chachapoly_key_buf), &key_id),
			      PSA_SUCCESS, "Failed to import key");
	}

	zassert_equal(psa_aead_encrypt(key_id, alg, chachapoly_nonce_buf,
				       sizeof(chachapoly_nonce_buf), chachapoly_ad_buf,
				       sizeof(chachapoly_ad_buf), chachapoly_plaintext,
				       sizeof(chachapoly_plaintext), cipher_tag_buf,
				       sizeof(cipher_tag_buf), &enc_len),
		      PSA_SUCCESS, "Failed to encrypt");

	zassert_equal(enc_len, sizeof(chachapoly_expect_cipher_tag_buf));
	if (!generate_key) {
		size_t i = 0;

		for (i = 0; i < sizeof(chachapoly_expect_cipher_tag_buf); i++) {
			if (cipher_tag_buf[i] != chachapoly_expect_cipher_tag_buf[i]) {
				break;
			}
		}
		zassert_mem_equal(cipher_tag_buf, chachapoly_expect_cipher_tag_buf,
				  sizeof(chachapoly_expect_cipher_tag_buf),
				  "First mismatch at offset %d/%d", i,
				  sizeof(chachapoly_expect_cipher_tag_buf));
	}

	zassert_equal(psa_aead_decrypt(key_id, alg, chachapoly_nonce_buf,
				       sizeof(chachapoly_nonce_buf), chachapoly_ad_buf,
				       sizeof(chachapoly_ad_buf), cipher_tag_buf, enc_len,
				       decrypted, sizeof(decrypted), &out_len),
		      PSA_SUCCESS, "Failed to decrypt");

	zassert_equal(out_len, sizeof(chachapoly_plaintext));
	zassert_mem_equal(decrypted, chachapoly_plaintext, sizeof(chachapoly_plaintext));

	memset(&cipher_tag_buf[sizeof(chachapoly_plaintext)], 0, 16);
	zassert_equal(psa_aead_decrypt(key_id, alg, chachapoly_nonce_buf,
				       sizeof(chachapoly_nonce_buf), chachapoly_ad_buf,
				       sizeof(chachapoly_ad_buf), cipher_tag_buf, enc_len,
				       decrypted, sizeof(decrypted), &out_len),
		      PSA_ERROR_INVALID_SIGNATURE, "Decrypt succeeded despite bad tag");

	zassert_equal(psa_destroy_key(key_id), PSA_SUCCESS, "Failed to destroy key");
}

void test_aead_chacha20_poly1305_long(bool generate_key, psa_key_location_t location)
{
	size_t out_len;

	psa_key_id_t key_id;
	psa_key_attributes_t attributes = PSA_KEY_ATTRIBUTES_INIT;
	psa_algorithm_t alg = PSA_ALG_CHACHA20_POLY1305;

	psa_set_key_usage_flags(&attributes, PSA_KEY_USAGE_ENCRYPT | PSA_KEY_USAGE_DECRYPT);
	psa_set_key_algorithm(&attributes, alg);
	psa_set_key_type(&attributes, PSA_KEY_TYPE_CHACHA20);
	psa_set_key_bits(&attributes, 256);
	psa_set_key_lifetime(&attributes, PSA_KEY_LIFETIME_FROM_PERSISTENCE_AND_LOCATION(
						  PSA_KEY_PERSISTENCE_VOLATILE, location));

	if (generate_key) {
		zassert_equal(psa_generate_key(&attributes, &key_id), PSA_SUCCESS,
			      "Failed to generate key");
	} else {
		zassert_equal(psa_import_key(&attributes, chachapoly_key_buf,
					     sizeof(chachapoly_key_buf), &key_id),
			      PSA_SUCCESS, "Failed to import key");
	}

	zassert_equal(psa_aead_encrypt(key_id, alg, chachapoly_nonce_buf,
				       sizeof(chachapoly_nonce_buf), chachapoly_ad_buf,
				       sizeof(chachapoly_ad_buf), long_plaintext,
				       sizeof(long_plaintext), long_cipher_tag_buf,
				       sizeof(long_cipher_tag_buf), &out_len),
		      PSA_SUCCESS, "Failed to encrypt");

	zassert_equal(out_len, sizeof(long_cipher_tag_buf));

	zassert_equal(psa_aead_decrypt(key_id, alg, chachapoly_nonce_buf,
				       sizeof(chachapoly_nonce_buf), chachapoly_ad_buf,
				       sizeof(chachapoly_ad_buf), long_cipher_tag_buf, out_len,
				       long_decrypted, sizeof(long_decrypted), &out_len),
		      PSA_SUCCESS, "Failed to decrypt");

	zassert_equal(out_len, sizeof(long_plaintext));
	zassert_mem_equal(long_decrypted, long_plaintext, sizeof(long_plaintext));

	zassert_equal(psa_destroy_key(key_id), PSA_SUCCESS, "Failed to destroy key");
}

ZTEST(psa_crypto_test, test_aead_aes_ccm_transparent)
{
	test_aead_aes_ccm(false, 0);
	test_aead_aes_ccm(true, 0);
}

ZTEST(psa_crypto_test, test_aead_aes_ccm_long_transparent)
{
	test_aead_aes_ccm_long(false, 0);
	test_aead_aes_ccm_long(true, 0);
}

ZTEST(psa_crypto_test, test_aead_aes_ccm_opaque)
{
	if (!IS_ENABLED(TEST_OPAQUE_AEAD)) {
		ztest_test_skip();
	}

	if (!IS_ENABLED(TEST_OPAQUE_NO_IMPORT_KEY)) {
		test_aead_aes_ccm(false, 1);
	}

	test_aead_aes_ccm(true, 1);
}

ZTEST(psa_crypto_test, test_aead_aes_gcm_transparent)
{
	test_aead_aes_gcm(false, 0);
	test_aead_aes_gcm(true, 0);
}

ZTEST(psa_crypto_test, test_aead_aes_gcm_long_transparent)
{
	test_aead_aes_gcm_long(false, 0);
	test_aead_aes_gcm_long(true, 0);
}

ZTEST(psa_crypto_test, test_aead_aes_gcm_opaque)
{
	if (!IS_ENABLED(TEST_OPAQUE_AEAD)) {
		ztest_test_skip();
	}

	if (!IS_ENABLED(TEST_OPAQUE_NO_IMPORT_KEY)) {
		test_aead_aes_gcm(false, 1);
	}

	test_aead_aes_gcm(true, 1);
}

ZTEST(psa_crypto_test, test_aead_chacha20_poly1305_transparent)
{
	test_aead_chacha20_poly1305(false, 0);
	test_aead_chacha20_poly1305(true, 0);
}

ZTEST(psa_crypto_test, test_aead_chacha20_poly1305_long_transparent)
{
	test_aead_chacha20_poly1305_long(false, 0);
	test_aead_chacha20_poly1305_long(true, 0);
}

ZTEST(psa_crypto_test, test_aead_chacha20_poly1305_opaque)
{
	if (!IS_ENABLED(TEST_OPAQUE_AEAD) || IS_ENABLED(TEST_OPAQUE_NO_CHACHA)) {
		ztest_test_skip();
	}

	if (!IS_ENABLED(TEST_OPAQUE_NO_IMPORT_KEY)) {
		test_aead_chacha20_poly1305(false, 1);
	}

	test_aead_chacha20_poly1305(true, 1);
}
```

## src/cipher.c
```c
/*
 * Copyright (c) 2025 Silicon Laboratories Inc.
 *
 * SPDX-License-Identifier: Apache-2.0
 */

#include <zephyr/ztest.h>
#include <psa/crypto.h>

#include "test_vectors.h"

static uint8_t key_256[32] = {
	0x31, 0x4b, 0x66, 0x77, 0x19, 0x39, 0x73, 0x17, 0x7d, 0xaf, 0x98,
	0x3d, 0x5d, 0x31, 0x26, 0x02, 0x31, 0x4b, 0x66, 0x77, 0x19, 0x39,
	0x73, 0x17, 0x7d, 0xaf, 0x98, 0x3d, 0x5d, 0x31, 0x26, 0x02,
};

static uint8_t key_128[16] = {
	0x73, 0x17, 0x7d, 0xaf, 0x98, 0x3d, 0x5d, 0x31,
	0x26, 0x02, 0x73, 0x17, 0x7d, 0xaf, 0x98, 0x02,
};

static uint8_t ciphertext[sizeof(plaintext)];
static uint8_t ciphertext_buffer_256[sizeof(plaintext) + sizeof(key_256)];
static uint8_t decrypted[sizeof(ciphertext)];
static uint8_t long_ciphertext_buffer_256[sizeof(long_plaintext) + sizeof(key_256)];
static uint8_t long_decrypted[sizeof(long_plaintext)];
static size_t ciphertext_len;
static size_t decrypted_len;

void test_cipher_aes_cbc_256_multipart(bool generate_key, psa_key_location_t location)
{
	psa_key_id_t key_id;
	psa_key_attributes_t attributes = PSA_KEY_ATTRIBUTES_INIT;
	psa_algorithm_t alg = PSA_ALG_CBC_NO_PADDING;
	psa_cipher_operation_t operation = PSA_CIPHER_OPERATION_INIT;

	uint8_t iv[PSA_BLOCK_CIPHER_BLOCK_LENGTH(PSA_KEY_TYPE_AES)];
	size_t iv_len;

	psa_set_key_usage_flags(&attributes, PSA_KEY_USAGE_ENCRYPT | PSA_KEY_USAGE_DECRYPT);
	psa_set_key_algorithm(&attributes, alg);
	psa_set_key_type(&attributes, PSA_KEY_TYPE_AES);
	psa_set_key_bits(&attributes, 256);
	psa_set_key_lifetime(&attributes, PSA_KEY_LIFETIME_FROM_PERSISTENCE_AND_LOCATION(
						  PSA_KEY_PERSISTENCE_VOLATILE, location));
	if (generate_key) {
		zassert_equal(psa_generate_key(&attributes, &key_id), PSA_SUCCESS,
			      "Failed to generate key");
	} else {
		zassert_equal(psa_import_key(&attributes, key_256, sizeof(key_256), &key_id),
			      PSA_SUCCESS, "Failed to import key");
	}
	psa_reset_key_attributes(&attributes);

	zassert_equal(psa_cipher_encrypt_setup(&operation, key_id, alg), PSA_SUCCESS,
		      "Failed to begin encrypt operation");
	zassert_equal(psa_cipher_generate_iv(&operation, iv, sizeof(iv), &iv_len), PSA_SUCCESS,
		      "Failed to generate IV");
	zassert_equal(psa_cipher_update(&operation, plaintext, sizeof(plaintext), ciphertext,
					sizeof(ciphertext), &ciphertext_len),
		      PSA_SUCCESS, "Failed to update encrypt operation");
	zassert_equal(psa_cipher_finish(&operation, ciphertext + ciphertext_len,
					sizeof(ciphertext) - ciphertext_len, &ciphertext_len),
		      PSA_SUCCESS, "Failed to finish encrypt operation");

	psa_cipher_abort(&operation);

	zassert(memcmp(ciphertext, plaintext, sizeof(plaintext)) != 0,
		"Ciphertext identical to plaintext");

	zassert_equal(psa_cipher_decrypt_setup(&operation, key_id, alg), PSA_SUCCESS,
		      "Failed to begin decrypt operation");
	zassert_equal(psa_cipher_set_iv(&operation, iv, sizeof(iv)), PSA_SUCCESS,
		      "Failed to set IV");
	zassert_equal(psa_cipher_update(&operation, ciphertext, sizeof(ciphertext), decrypted,
					sizeof(decrypted), &decrypted_len),
		      PSA_SUCCESS, "Failed to update decrypt operation");
	zassert_equal(decrypted_len, sizeof(decrypted), "Decrypted length mismatch");
	zassert_equal(psa_cipher_finish(&operation, decrypted + decrypted_len,
					sizeof(decrypted) - decrypted_len, &decrypted_len),
		      PSA_SUCCESS, "Failed to finish decrypt operation");

	psa_cipher_abort(&operation);

	zassert_mem_equal(decrypted, plaintext, sizeof(plaintext));

	zassert_equal(psa_destroy_key(key_id), PSA_SUCCESS, "Failed to destroy key");
}

void test_cipher_aes_cbc_256_single(bool generate_key, psa_key_location_t location)
{
	psa_key_id_t key_id;
	psa_key_attributes_t attributes = PSA_KEY_ATTRIBUTES_INIT;
	psa_algorithm_t alg = PSA_ALG_CBC_NO_PADDING;

	psa_set_key_usage_flags(&attributes, PSA_KEY_USAGE_ENCRYPT | PSA_KEY_USAGE_DECRYPT);
	psa_set_key_algorithm(&attributes, alg);
	psa_set_key_type(&attributes, PSA_KEY_TYPE_AES);
	psa_set_key_bits(&attributes, 256);
	psa_set_key_lifetime(&attributes, PSA_KEY_LIFETIME_FROM_PERSISTENCE_AND_LOCATION(
						  PSA_KEY_PERSISTENCE_VOLATILE, location));
	if (generate_key) {
		zassert_equal(psa_generate_key(&attributes, &key_id), PSA_SUCCESS,
			      "Failed to generate key");
	} else {
		zassert_equal(psa_import_key(&attributes, key_256, sizeof(key_256), &key_id),
			      PSA_SUCCESS, "Failed to import key");
	}
	psa_reset_key_attributes(&attributes);

	zassert_equal(psa_cipher_encrypt(key_id, alg, plaintext, sizeof(plaintext),
					 ciphertext_buffer_256, sizeof(ciphertext_buffer_256),
					 &ciphertext_len),
		      PSA_SUCCESS, "Failed to perform one-shot encrypt operation");

	zassert(memcmp(ciphertext_buffer_256, plaintext, sizeof(plaintext)) != 0,
		"Ciphertext identical to plaintext");

	zassert_equal(psa_cipher_decrypt(key_id, alg, ciphertext_buffer_256, ciphertext_len,
					 decrypted, sizeof(decrypted), &decrypted_len),
		      PSA_SUCCESS, "Failed to perform one-shot decrypt operation");

	zassert_equal(decrypted_len, sizeof(decrypted), "Decrypted length mismatch");
	zassert_mem_equal(decrypted, plaintext, sizeof(plaintext));

	ciphertext_buffer_256[0] += 1;
	zassert_equal(psa_cipher_decrypt(key_id, alg, ciphertext_buffer_256, ciphertext_len,
					 decrypted, sizeof(decrypted), &decrypted_len),
		      PSA_SUCCESS,
		      "Failed to perform one-shot decrypt operation with modified ciphertext");

	zassert_equal(decrypted_len, sizeof(decrypted), "Decrypted length mismatch");
	zassert(memcmp(decrypted, plaintext, sizeof(plaintext)) != 0,
		"Decrypted modified data identical to original plaintext");

	zassert_equal(psa_destroy_key(key_id), PSA_SUCCESS, "Failed to destroy key");
}

void test_cipher_aes_cbc_256_long_single(bool generate_key, psa_key_location_t location)
{
	psa_key_id_t key_id;
	psa_key_attributes_t attributes = PSA_KEY_ATTRIBUTES_INIT;
	psa_algorithm_t alg = PSA_ALG_CBC_NO_PADDING;

	psa_set_key_usage_flags(&attributes, PSA_KEY_USAGE_ENCRYPT | PSA_KEY_USAGE_DECRYPT);
	psa_set_key_algorithm(&attributes, alg);
	psa_set_key_type(&attributes, PSA_KEY_TYPE_AES);
	psa_set_key_bits(&attributes, 256);
	psa_set_key_lifetime(&attributes, PSA_KEY_LIFETIME_FROM_PERSISTENCE_AND_LOCATION(
						  PSA_KEY_PERSISTENCE_VOLATILE, location));
	if (generate_key) {
		zassert_equal(psa_generate_key(&attributes, &key_id), PSA_SUCCESS,
			      "Failed to generate key");
	} else {
		zassert_equal(psa_import_key(&attributes, key_256, sizeof(key_256), &key_id),
			      PSA_SUCCESS, "Failed to import key");
	}
	psa_reset_key_attributes(&attributes);

	zassert_equal(psa_cipher_encrypt(key_id, alg, long_plaintext, sizeof(long_plaintext),
					 long_ciphertext_buffer_256,
					 sizeof(long_ciphertext_buffer_256), &ciphertext_len),
		      PSA_SUCCESS, "Failed to perform one-shot encrypt operation");

	zassert(memcmp(long_ciphertext_buffer_256, long_plaintext, sizeof(long_plaintext)) != 0,
		"Ciphertext identical to plaintext");

	zassert_equal(psa_cipher_decrypt(key_id, alg, long_ciphertext_buffer_256, ciphertext_len,
					 long_decrypted, sizeof(long_decrypted), &decrypted_len),
		      PSA_SUCCESS, "Failed to perform one-shot decrypt operation");

	zassert_equal(decrypted_len, sizeof(long_decrypted), "Decrypted length mismatch");
	zassert_mem_equal(long_decrypted, long_plaintext, sizeof(long_plaintext));

	long_ciphertext_buffer_256[0] += 1;
	zassert_equal(psa_cipher_decrypt(key_id, alg, long_ciphertext_buffer_256, ciphertext_len,
					 long_decrypted, sizeof(long_decrypted), &decrypted_len),
		      PSA_SUCCESS,
		      "Failed to perform one-shot decrypt operation with modified ciphertext");

	zassert_equal(decrypted_len, sizeof(long_decrypted), "Decrypted length mismatch");
	zassert(memcmp(long_decrypted, long_plaintext, sizeof(long_plaintext)) != 0,
		"Decrypted modified data identical to original plaintext");

	zassert_equal(psa_destroy_key(key_id), PSA_SUCCESS, "Failed to destroy key");
}

void test_cipher_aes_ecb_128_single(bool generate_key, psa_key_location_t location)
{
	psa_key_id_t key_id;
	psa_key_attributes_t attributes = PSA_KEY_ATTRIBUTES_INIT;
	psa_algorithm_t alg = PSA_ALG_ECB_NO_PADDING;

	psa_set_key_usage_flags(&attributes, PSA_KEY_USAGE_ENCRYPT | PSA_KEY_USAGE_DECRYPT);
	psa_set_key_algorithm(&attributes, alg);
	psa_set_key_type(&attributes, PSA_KEY_TYPE_AES);
	psa_set_key_bits(&attributes, 128);
	psa_set_key_lifetime(&attributes, PSA_KEY_LIFETIME_FROM_PERSISTENCE_AND_LOCATION(
						  PSA_KEY_PERSISTENCE_VOLATILE, location));
	if (generate_key) {
		zassert_equal(psa_generate_key(&attributes, &key_id), PSA_SUCCESS,
			      "Failed to generate key");
	} else {
		zassert_equal(psa_import_key(&attributes, key_128, sizeof(key_128), &key_id),
			      PSA_SUCCESS, "Failed to import key");
	}
	psa_reset_key_attributes(&attributes);

	zassert_equal(psa_cipher_encrypt(key_id, alg, plaintext, sizeof(plaintext), ciphertext,
					 sizeof(ciphertext), &ciphertext_len),
		      PSA_SUCCESS, "Failed to perform one-shot encrypt operation");

	zassert(memcmp(ciphertext, plaintext, sizeof(plaintext)) != 0,
		"Ciphertext identical to plaintext");

	zassert_equal(psa_cipher_decrypt(key_id, alg, ciphertext, ciphertext_len, decrypted,
					 sizeof(decrypted), &decrypted_len),
		      PSA_SUCCESS, "Failed to perform one-shot decrypt operation");
	zassert_equal(decrypted_len, sizeof(decrypted), "Decrypted length mismatch");
	zassert_mem_equal(decrypted, plaintext, sizeof(plaintext));

	ciphertext[0] += 1;
	zassert_equal(psa_cipher_decrypt(key_id, alg, ciphertext, ciphertext_len, decrypted,
					 sizeof(decrypted), &decrypted_len),
		      PSA_SUCCESS,
		      "Failed to perform one-shot decrypt operation with modified ciphertext");

	zassert_equal(decrypted_len, sizeof(decrypted), "Decrypted length mismatch");
	zassert(memcmp(decrypted, plaintext, sizeof(plaintext)) != 0,
		"Decrypted modified data identical to original plaintext");

	zassert_equal(psa_destroy_key(key_id), PSA_SUCCESS, "Failed to destroy key");
}

void test_cipher_chacha20_single(bool generate_key, psa_key_location_t location)
{
	psa_key_id_t key_id;
	psa_key_attributes_t attributes = PSA_KEY_ATTRIBUTES_INIT;
	psa_algorithm_t alg = PSA_ALG_STREAM_CIPHER;
	size_t out_len;

	psa_set_key_usage_flags(&attributes, PSA_KEY_USAGE_ENCRYPT | PSA_KEY_USAGE_DECRYPT);
	psa_set_key_algorithm(&attributes, alg);
	psa_set_key_type(&attributes, PSA_KEY_TYPE_CHACHA20);
	psa_set_key_bits(&attributes, 256);
	psa_set_key_lifetime(&attributes, PSA_KEY_LIFETIME_FROM_PERSISTENCE_AND_LOCATION(
						  PSA_KEY_PERSISTENCE_VOLATILE, location));
	if (generate_key) {
		zassert_equal(psa_generate_key(&attributes, &key_id), PSA_SUCCESS,
			      "Failed to generate key");
	} else {
		zassert_equal(psa_import_key(&attributes, key_256, sizeof(key_256), &key_id),
			      PSA_SUCCESS, "Failed to import key");
	}

	zassert_equal(psa_cipher_encrypt(key_id, alg, plaintext, sizeof(plaintext),
					 ciphertext_buffer_256, sizeof(ciphertext_buffer_256),
					 &out_len),
		      PSA_SUCCESS, "Failed to encrypt");

	zassert(memcmp(ciphertext_buffer_256, plaintext, sizeof(plaintext)) != 0,
		"Ciphertext identical to plaintext");

	zassert_equal(psa_cipher_decrypt(key_id, alg, ciphertext_buffer_256, out_len, decrypted,
					 sizeof(decrypted), &out_len),
		      PSA_SUCCESS, "Failed to decrypt");

	zassert_mem_equal(decrypted, plaintext, sizeof(plaintext));

	zassert_equal(psa_destroy_key(key_id), PSA_SUCCESS, "Failed to destroy key");
}

/* AES-CBC-256 Multipart */

ZTEST(psa_crypto_test, test_cipher_aes_cbc_256_multipart_transparent)
{
	test_cipher_aes_cbc_256_multipart(false, 0);
	test_cipher_aes_cbc_256_multipart(true, 0);
}

ZTEST(psa_crypto_test, test_cipher_aes_cbc_256_multipart_opaque)
{
	if (!IS_ENABLED(TEST_OPAQUE_CIPHER) || IS_ENABLED(TEST_OPAQUE_NO_MULTIPART)) {
		ztest_test_skip();
	}

	if (!IS_ENABLED(TEST_OPAQUE_NO_IMPORT_KEY)) {
		test_cipher_aes_cbc_256_multipart(false, 1);
	}
	test_cipher_aes_cbc_256_multipart(true, 1);
}

/* AES-CBC-256 Single */

ZTEST(psa_crypto_test, test_cipher_aes_cbc_256_single_transparent)
{
	test_cipher_aes_cbc_256_single(false, 0);
	test_cipher_aes_cbc_256_single(true, 0);
}

ZTEST(psa_crypto_test, test_cipher_aes_cbc_256_single_opaque)
{
	if (!IS_ENABLED(TEST_OPAQUE_CIPHER)) {
		ztest_test_skip();
	}

	if (!IS_ENABLED(TEST_OPAQUE_NO_IMPORT_KEY)) {
		test_cipher_aes_cbc_256_single(false, 1);
	}
	test_cipher_aes_cbc_256_single(true, 1);
}

ZTEST(psa_crypto_test, test_cipher_aes_cbc_256_long_single_transparent)
{
	test_cipher_aes_cbc_256_long_single(false, 0);
	test_cipher_aes_cbc_256_long_single(true, 0);
}

ZTEST(psa_crypto_test, test_cipher_aes_cbc_256_long_single_opaque)
{
	if (!IS_ENABLED(TEST_OPAQUE_CIPHER)) {
		ztest_test_skip();
	}

	if (!IS_ENABLED(TEST_OPAQUE_NO_IMPORT_KEY)) {
		test_cipher_aes_cbc_256_long_single(false, 1);
	}
	test_cipher_aes_cbc_256_long_single(true, 1);
}

/* AES-ECB-128 Single */

ZTEST(psa_crypto_test, test_cipher_aes_ecb_128_single_transparent)
{
	test_cipher_aes_ecb_128_single(false, 0);
	test_cipher_aes_ecb_128_single(true, 0);
}

ZTEST(psa_crypto_test, test_cipher_aes_ecb_128_single_opaque)
{
	if (!IS_ENABLED(TEST_OPAQUE_CIPHER)) {
		ztest_test_skip();
	}

	if (!IS_ENABLED(TEST_OPAQUE_NO_IMPORT_KEY)) {
		test_cipher_aes_ecb_128_single(false, 1);
	}
	test_cipher_aes_ecb_128_single(true, 1);
}

/* ChaCha20 Single */
ZTEST(psa_crypto_test, test_cipher_chacha20_single_transparent)
{
	test_cipher_chacha20_single(false, 0);
	test_cipher_chacha20_single(true, 0);
}

ZTEST(psa_crypto_test, test_cipher_chacha20_single_opaque)
{
	if (!IS_ENABLED(TEST_OPAQUE_CIPHER) || IS_ENABLED(TEST_OPAQUE_NO_CHACHA)) {
		ztest_test_skip();
	}

	if (!IS_ENABLED(TEST_OPAQUE_NO_IMPORT_KEY)) {
		test_cipher_chacha20_single(false, 1);
	}
	test_cipher_chacha20_single(true, 1);
}
```

## src/hash.c
```c
/*
 * Copyright (c) 2025 Silicon Laboratories Inc.
 *
 * SPDX-License-Identifier: Apache-2.0
 */

#include <zephyr/ztest.h>
#include <psa/crypto.h>

#include "test_vectors.h"

const uint8_t expect_sha256_hash[32] = {
	0xeb, 0x82, 0x57, 0x4e, 0x4b, 0x80, 0x69, 0xe7, 0xcc, 0x2d, 0xf8,
	0xb1, 0x2c, 0x85, 0xb7, 0x4b, 0x40, 0x9f, 0x26, 0xb5, 0x48, 0x51,
	0x0b, 0x45, 0x1a, 0x4b, 0xf2, 0xcb, 0x81, 0xfd, 0x46, 0x76,
};

const uint8_t expect_sha256_hash_long[32] = {
	0x4b, 0x8b, 0x0b, 0xab, 0x7c, 0x6f, 0xea, 0xe7, 0xa3, 0x80, 0x87,
	0xec, 0x05, 0x6a, 0xd5, 0x16, 0x9b, 0x6f, 0xd9, 0x6c, 0xd1, 0xbb,
	0x13, 0xd1, 0xa8, 0x2a, 0x65, 0x10, 0x37, 0x5c, 0x7a, 0xc9,
};

ZTEST(psa_crypto_test, test_hash_sha256)
{
	uint8_t hash_buf[32];
	size_t hash_len;

	zassert_equal(psa_hash_compute(PSA_ALG_SHA_256, plaintext, sizeof(plaintext), hash_buf,
				       sizeof(hash_buf), &hash_len),
		      PSA_SUCCESS, "Failed to compute hash");
	zassert_equal(hash_len, sizeof(expect_sha256_hash), "Hash length mismatch");
	zassert_mem_equal(hash_buf, expect_sha256_hash, sizeof(expect_sha256_hash),
			  "Hash mismatch");

	zassert_equal(psa_hash_compare(PSA_ALG_SHA_256, plaintext, sizeof(plaintext),
				       expect_sha256_hash, sizeof(expect_sha256_hash)),
		      PSA_SUCCESS, "Failed to compare hash");
}

ZTEST(psa_crypto_test, test_hash_sha256_long)
{
	uint8_t hash_buf[32];
	size_t hash_len;

	zassert_equal(psa_hash_compute(PSA_ALG_SHA_256, long_plaintext, sizeof(long_plaintext),
				       hash_buf, sizeof(hash_buf), &hash_len),
		      PSA_SUCCESS, "Failed to compute hash");
	zassert_equal(hash_len, sizeof(expect_sha256_hash_long), "Hash length mismatch");
	zassert_mem_equal(hash_buf, expect_sha256_hash_long, sizeof(expect_sha256_hash_long),
			  "Hash mismatch");

	zassert_equal(psa_hash_compare(PSA_ALG_SHA_256, long_plaintext, sizeof(long_plaintext),
				       expect_sha256_hash_long, sizeof(expect_sha256_hash_long)),
		      PSA_SUCCESS, "Failed to compare hash");
}

ZTEST(psa_crypto_test, test_hash_sha256_multipart)
{
	uint8_t hash_buf[32];
	size_t hash_len;
	uint32_t stream_block_size = 128;
	size_t hash_total = 0;
	psa_hash_operation_t hash_op = psa_hash_operation_init();

	zassert_equal(psa_hash_setup(&hash_op, PSA_ALG_SHA_256), PSA_SUCCESS,
		      "Failed to setup hash");

	while ((sizeof(plaintext) - hash_total) > stream_block_size) {
		zassert_equal(
			psa_hash_update(&hash_op, (plaintext + hash_total), stream_block_size),
			PSA_SUCCESS, "Failed to update hash");
		hash_total += stream_block_size;
	}
	zassert_equal(
		psa_hash_update(&hash_op, (plaintext + hash_total), sizeof(plaintext) - hash_total),
		PSA_SUCCESS, "Failed to update hash");

	zassert_equal(psa_hash_finish(&hash_op, hash_buf, sizeof(hash_buf), &hash_len), PSA_SUCCESS,
		      "Failed to finish hash");
	zassert_equal(hash_len, sizeof(expect_sha256_hash), "Hash length mismatch");
	zassert_mem_equal(hash_buf, expect_sha256_hash, sizeof(expect_sha256_hash),
			  "Hash mismatch");
}

ZTEST(psa_crypto_test, test_hash_sha256_multipart_parallel)
{
	uint8_t hash_buf1[32], hash_buf2[32];
	size_t hash_len1, hash_len2;
	uint32_t stream_block_size = 128;
	size_t hash_total1 = 0, hash_total2 = 0;

	psa_hash_operation_t hash_op1 = psa_hash_operation_init();
	psa_hash_operation_t hash_op2 = psa_hash_operation_init();

	zassert_equal(psa_hash_setup(&hash_op1, PSA_ALG_SHA_256), PSA_SUCCESS,
		      "Failed to setup hash");

	zassert_equal(psa_hash_setup(&hash_op2, PSA_ALG_SHA_256), PSA_SUCCESS,
		      "Failed to setup hash");

	while ((sizeof(plaintext) - hash_total1) > stream_block_size) {
		zassert_equal(
			psa_hash_update(&hash_op1, (plaintext + hash_total1), stream_block_size),
			PSA_SUCCESS, "Failed to update hash");
		hash_total1 += stream_block_size;
		zassert_equal(
			psa_hash_update(&hash_op2, (plaintext + hash_total2), stream_block_size),
			PSA_SUCCESS, "Failed to update hash");
		hash_total2 += stream_block_size;
	}
	zassert_equal(psa_hash_update(&hash_op1, (plaintext + hash_total1),
				      sizeof(plaintext) - hash_total1),
		      PSA_SUCCESS, "Failed to update hash");
	zassert_equal(psa_hash_update(&hash_op2, (plaintext + hash_total2),
				      sizeof(plaintext) - hash_total2),
		      PSA_SUCCESS, "Failed to update hash");

	zassert_equal(psa_hash_finish(&hash_op1, hash_buf1, sizeof(hash_buf1), &hash_len1),
		      PSA_SUCCESS, "Failed to finish hash");
	zassert_equal(hash_len1, sizeof(expect_sha256_hash), "Hash length mismatch");
	zassert_mem_equal(hash_buf1, expect_sha256_hash, sizeof(expect_sha256_hash),
			  "Hash mismatch");

	zassert_equal(psa_hash_finish(&hash_op2, hash_buf2, sizeof(hash_buf2), &hash_len2),
		      PSA_SUCCESS, "Failed to finish hash");
	zassert_equal(hash_len2, sizeof(expect_sha256_hash), "Hash length mismatch");
	zassert_mem_equal(hash_buf2, expect_sha256_hash, sizeof(expect_sha256_hash),
			  "Hash mismatch");
}
```

## src/key_agreement.c
```c
/*
 * Copyright (c) 2025 Silicon Laboratories Inc.
 *
 * SPDX-License-Identifier: Apache-2.0
 */

#include <zephyr/ztest.h>
#include <psa/crypto.h>

static const uint8_t client_private_key[] = {
	0xB0, 0x76, 0x51, 0xEA, 0x20, 0xF0, 0x28, 0xA8, 0x16, 0xEE, 0x01,
	0xB0, 0xD1, 0x06, 0x2A, 0x7C, 0x81, 0x58, 0xE8, 0x84, 0xE9, 0xBC,
	0xC6, 0x1C, 0x5D, 0xAB, 0xDB, 0x4E, 0x38, 0x2F, 0x96, 0x69,
};
static const uint8_t client_public_key[] = {
	0x87, 0xD8, 0x6B, 0xDA, 0xAC, 0x38, 0x3C, 0x85, 0xA6, 0xBC, 0xF8,
	0xFC, 0xC6, 0x26, 0xD6, 0x14, 0x36, 0xE4, 0x8F, 0xDB, 0xFA, 0x5A,
	0x45, 0xFE, 0x0C, 0x9E, 0xA8, 0x4B, 0x35, 0x3E, 0xF1, 0x37,
};
static const uint8_t server_private_key[] = {
	0x98, 0x2E, 0xB6, 0x7D, 0x0A, 0x01, 0x57, 0x90, 0xE1, 0x45, 0xF3,
	0x67, 0xF6, 0xDA, 0xA6, 0x44, 0x2C, 0x87, 0xC0, 0xED, 0x3C, 0x36,
	0x71, 0xA6, 0x89, 0xC7, 0x49, 0xAC, 0x0D, 0xFE, 0x43, 0x6E,
};
static const uint8_t server_public_key[] = {
	0x0C, 0x04, 0x10, 0x5B, 0xE8, 0x7C, 0xAB, 0x37, 0x21, 0x15, 0x7A,
	0x8D, 0x49, 0x85, 0x8C, 0x7A, 0x9F, 0xC1, 0x46, 0xDA, 0xCC, 0x96,
	0xEF, 0x6E, 0xD4, 0xDA, 0x71, 0xBF, 0xED, 0x32, 0x0D, 0x76,
};
static const uint8_t expected_shared_secret[] = {
	0xF2, 0xE6, 0x0E, 0x1C, 0xB7, 0x64, 0xBC, 0x48, 0xF2, 0x9D, 0xBB,
	0x12, 0xFB, 0x12, 0x17, 0x31, 0x32, 0x1D, 0x79, 0xAF, 0x0A, 0x9F,
	0xAB, 0xAD, 0x34, 0x05, 0xA2, 0x07, 0x39, 0x9C, 0x5F, 0x15,
};

void test_key_agreement_ecdh_25519(psa_key_location_t location)
{
	uint8_t shared_secret_buf[32];
	size_t shared_secret_len;
	psa_key_id_t key_id;
	psa_key_attributes_t attributes = PSA_KEY_ATTRIBUTES_INIT;

	/* Import client key */
	psa_set_key_type(&attributes, PSA_KEY_TYPE_ECC_KEY_PAIR(PSA_ECC_FAMILY_MONTGOMERY));
	psa_set_key_usage_flags(&attributes, PSA_KEY_USAGE_DERIVE);
	psa_set_key_algorithm(&attributes, PSA_ALG_ECDH);
	psa_set_key_lifetime(&attributes, PSA_KEY_LIFETIME_FROM_PERSISTENCE_AND_LOCATION(
						  PSA_KEY_PERSISTENCE_VOLATILE, location));
	zassert_equal(psa_import_key(&attributes, client_private_key, sizeof(client_private_key),
				     &key_id),
		      PSA_SUCCESS, "Failed to import client key");

	/* Perform key agreement with server public key */
	zassert_equal(psa_raw_key_agreement(PSA_ALG_ECDH, key_id, server_public_key,
					    sizeof(server_public_key), shared_secret_buf,
					    sizeof(shared_secret_buf), &shared_secret_len),
		      PSA_SUCCESS, "Failed to perform key agreement with server");
	zassert_equal(psa_destroy_key(key_id), PSA_SUCCESS, "Failed to destroy client key");

	/* Import server key */
	attributes = psa_key_attributes_init();
	psa_set_key_type(&attributes, PSA_KEY_TYPE_ECC_KEY_PAIR(PSA_ECC_FAMILY_MONTGOMERY));
	psa_set_key_usage_flags(&attributes, PSA_KEY_USAGE_DERIVE);
	psa_set_key_algorithm(&attributes, PSA_ALG_ECDH);
	psa_set_key_lifetime(&attributes, PSA_KEY_LIFETIME_FROM_PERSISTENCE_AND_LOCATION(
						  PSA_KEY_PERSISTENCE_VOLATILE, location));
	zassert_equal(psa_import_key(&attributes, server_private_key, sizeof(server_private_key),
				     &key_id),
		      PSA_SUCCESS, "Failed to import server key");

	/* Perform key agreement with client public key */
	zassert_equal(psa_raw_key_agreement(PSA_ALG_ECDH, key_id, client_public_key,
					    sizeof(client_public_key), shared_secret_buf,
					    sizeof(shared_secret_buf), &shared_secret_len),
		      PSA_SUCCESS, "Failed to perform key agreement with client");
	zassert_equal(psa_destroy_key(key_id), PSA_SUCCESS, "Failed to destroy server key");

	/* Verify shared secret */
	zassert_mem_equal(shared_secret_buf, expected_shared_secret, sizeof(expected_shared_secret),
			  "Key agreement did not resolve the correct shared secret");
}

ZTEST(psa_crypto_test, test_key_agreement_ecdh_25519_transparent)
{
	test_key_agreement_ecdh_25519(0);
}

ZTEST(psa_crypto_test, test_key_agreement_ecdh_25519_opaque)
{
	if (!IS_ENABLED(TEST_OPAQUE_KEY_AGREEMENT)) {
		ztest_test_skip();
	}

	test_key_agreement_ecdh_25519(1);
}
```

## src/mac.c
```c
/*
 * Copyright (c) 2026 Silicon Laboratories Inc.
 *
 * SPDX-License-Identifier: Apache-2.0
 */

#include <zephyr/ztest.h>
#include <psa/crypto.h>

#include "test_vectors.h"

static uint8_t key[32] = {
	0x99, 0x1a, 0xbd, 0x17, 0x1c, 0x3e, 0x55, 0x1b, 0xed, 0x7a, 0xd9,
	0xae, 0x8f, 0x97, 0x23, 0xca, 0xc0, 0x38, 0x2a, 0x3d, 0xbb, 0x77,
	0x17, 0xea, 0x4a, 0x62, 0xb2, 0x5b, 0x89, 0x15, 0x15, 0xab,
};

static uint8_t expected_hmac[32] = {
	0x2e, 0x47, 0x95, 0x1f, 0xb3, 0x8e, 0x5a, 0xdf, 0x4c, 0x2c, 0xb4,
	0xdf, 0xc4, 0xfe, 0x51, 0x7e, 0x4e, 0x06, 0x2f, 0x27, 0xda, 0x75,
	0x25, 0x7a, 0xc4, 0x32, 0x4b, 0xd6, 0x6d, 0x10, 0xa9, 0xe0,
};

static uint8_t expected_hmac_384[48] = {
	0xdd, 0x97, 0xac, 0x58, 0x22, 0x1c, 0x22, 0x95, 0xa0, 0x41, 0xc9, 0x0f,
	0x65, 0xf7, 0x9f, 0x04, 0xa4, 0x21, 0xe0, 0xf2, 0x43, 0x92, 0x55, 0x65,
	0xdd, 0x89, 0x9a, 0x23, 0x0e, 0xbf, 0xad, 0x56, 0x71, 0x55, 0xb0, 0xcb,
	0x7a, 0xdb, 0x9a, 0x6d, 0x4c, 0x54, 0x80, 0xa1, 0x0a, 0xe6, 0x5d, 0xfb,
};

static uint8_t expected_hmac_512[64] = {
	0x90, 0x19, 0x38, 0x8c, 0x26, 0x0b, 0x83, 0x70, 0xcc, 0x33, 0x9a, 0xf9, 0xde,
	0x8e, 0x1f, 0x29, 0xa3, 0x3e, 0x18, 0x64, 0xfc, 0xa5, 0x3a, 0x11, 0x47, 0x84,
	0x82, 0xa6, 0xf2, 0x81, 0x9c, 0x7a, 0x61, 0x14, 0x82, 0xca, 0x3e, 0x8a, 0x25,
	0x69, 0xbc, 0x97, 0x0b, 0x9a, 0xc9, 0xa7, 0x73, 0x09, 0xd8, 0x0d, 0x11, 0xe8,
	0x26, 0x05, 0x92, 0x22, 0xfc, 0x1c, 0xb5, 0x24, 0xf0, 0x35, 0xab, 0x00,
};

static uint8_t expected_long_hmac[32] = {
	0xb8, 0xc7, 0xbb, 0x71, 0x82, 0xd0, 0x1f, 0xb4, 0x4c, 0x7e, 0x4f,
	0xd7, 0xd1, 0x40, 0xcf, 0x60, 0x1e, 0x0f, 0x9a, 0x1e, 0xdb, 0x4c,
	0x73, 0xf8, 0x33, 0xc0, 0x77, 0xa2, 0x35, 0xa5, 0xa9, 0xe8,
};

static uint8_t expected_cmac[16] = {
	0xc9, 0x09, 0x74, 0x42, 0xd2, 0x6a, 0x10, 0xff,
	0x13, 0xcc, 0x2a, 0xa2, 0x3b, 0xbe, 0xc2, 0xef,
};

static uint8_t expected_long_cmac[16] = {
	0x41, 0x0a, 0x6f, 0x2b, 0x4c, 0xab, 0xe6, 0xe7,
	0x8d, 0xe8, 0x9f, 0xf2, 0x80, 0xd2, 0xe2, 0x8e,
};

void test_mac(bool generate_key, psa_key_location_t location, const uint8_t *input,
	      size_t input_len, const uint8_t *expected, size_t expected_len, psa_algorithm_t alg,
	      psa_key_type_t type)
{
	psa_key_attributes_t attributes = PSA_KEY_ATTRIBUTES_INIT;
	psa_key_id_t key_id;

	uint8_t mac[64] = {0};
	size_t mac_len = 0;

	psa_set_key_usage_flags(&attributes,
				PSA_KEY_USAGE_SIGN_MESSAGE | PSA_KEY_USAGE_VERIFY_MESSAGE);
	psa_set_key_algorithm(&attributes, alg);
	psa_set_key_type(&attributes, type);
	psa_set_key_bits(&attributes, 256);
	psa_set_key_lifetime(&attributes, PSA_KEY_LIFETIME_FROM_PERSISTENCE_AND_LOCATION(
						  PSA_KEY_PERSISTENCE_VOLATILE, location));
	if (generate_key) {
		zassert_equal(psa_generate_key(&attributes, &key_id), PSA_SUCCESS,
			      "Failed to generate key");
	} else {
		zassert_equal(psa_import_key(&attributes, key, sizeof(key), &key_id), PSA_SUCCESS,
			      "Failed to import key");
	}

	zassert_equal(psa_mac_compute(key_id, alg, input, input_len, mac, sizeof(mac), &mac_len),
		      PSA_SUCCESS, "Failed to perform MAC operation");

	zassert_equal(mac_len, expected_len, "MAC length mismatch");
	if (!generate_key && expected) {
		zassert_mem_equal(mac, expected, expected_len);
	}

	zassert_equal(psa_mac_verify(key_id, alg, input, input_len, mac, mac_len), PSA_SUCCESS,
		      "Failed to verify MAC");

	zassert_equal(psa_destroy_key(key_id), PSA_SUCCESS, "Failed to destroy key");
}

ZTEST(psa_crypto_test, test_mac_hmac_transparent)
{
	test_mac(false, 0, plaintext, sizeof(plaintext), expected_hmac, sizeof(expected_hmac),
		 PSA_ALG_HMAC(PSA_ALG_SHA_256), PSA_KEY_TYPE_HMAC);
	test_mac(true, 0, plaintext, sizeof(plaintext), NULL, 32, PSA_ALG_HMAC(PSA_ALG_SHA_256),
		 PSA_KEY_TYPE_HMAC);

	test_mac(false, 0, plaintext, sizeof(plaintext), expected_hmac_384,
		 sizeof(expected_hmac_384), PSA_ALG_HMAC(PSA_ALG_SHA_384), PSA_KEY_TYPE_HMAC);
	test_mac(true, 0, plaintext, sizeof(plaintext), NULL, 48, PSA_ALG_HMAC(PSA_ALG_SHA_384),
		 PSA_KEY_TYPE_HMAC);

	test_mac(false, 0, plaintext, sizeof(plaintext), expected_hmac_512,
		 sizeof(expected_hmac_512), PSA_ALG_HMAC(PSA_ALG_SHA_512), PSA_KEY_TYPE_HMAC);
	test_mac(true, 0, plaintext, sizeof(plaintext), NULL, 64, PSA_ALG_HMAC(PSA_ALG_SHA_512),
		 PSA_KEY_TYPE_HMAC);
}

ZTEST(psa_crypto_test, test_mac_hmac_long_transparent)
{
	test_mac(false, 0, long_plaintext, sizeof(long_plaintext), expected_long_hmac,
		 sizeof(expected_long_hmac), PSA_ALG_HMAC(PSA_ALG_SHA_256), PSA_KEY_TYPE_HMAC);
	test_mac(true, 0, long_plaintext, sizeof(long_plaintext), NULL, 32,
		 PSA_ALG_HMAC(PSA_ALG_SHA_256), PSA_KEY_TYPE_HMAC);
}

ZTEST(psa_crypto_test, test_mac_cmac_transparent)
{
	test_mac(false, 0, plaintext, sizeof(plaintext), expected_cmac, sizeof(expected_cmac),
		 PSA_ALG_CMAC, PSA_KEY_TYPE_AES);
	test_mac(true, 0, plaintext, sizeof(plaintext), NULL, 16, PSA_ALG_CMAC, PSA_KEY_TYPE_AES);
}

ZTEST(psa_crypto_test, test_mac_cmac_long_transparent)
{
	test_mac(false, 0, long_plaintext, sizeof(long_plaintext), expected_long_cmac,
		 sizeof(expected_long_cmac), PSA_ALG_CMAC, PSA_KEY_TYPE_AES);
	test_mac(true, 0, long_plaintext, sizeof(long_plaintext), NULL, 16, PSA_ALG_CMAC,
		 PSA_KEY_TYPE_AES);
}
```

## src/test_vectors.h
```c
/*
 * Copyright (c) 2024 Silicon Laboratories Inc.
 *
 * SPDX-License-Identifier: Apache-2.0
 */
#ifndef ZEPHYR_TESTS_CRYPTO_PSA_CRYPTO_SRC_TEST_VECTORS_H_
#define ZEPHYR_TESTS_CRYPTO_PSA_CRYPTO_SRC_TEST_VECTORS_H_

#include <stdint.h>

extern const uint8_t plaintext[1024];
extern const uint8_t long_plaintext[4096];

#endif
```
