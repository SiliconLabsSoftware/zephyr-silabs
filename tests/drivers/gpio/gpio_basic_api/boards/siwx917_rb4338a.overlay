/*
 * Copyright (c) 2024 Silicon Laboratories Inc.
 *
 * SPDX-License-Identifier: Apache-2.0
 */

/ {
	resources {
		compatible = "test-gpio-basic-api";
		/* GPIO HP */
		out-gpios = <&gpiod 0 0>; /* WPK P28 */
		in-gpios = <&gpiod 2 0>; /* WPK P32 */
		/* GPIO UULP */
		// out-gpios = <&uulpgpio 0 0>; /* WPK P14 */
		// in-gpios = <&uulpgpio 3 0>; /* WPK P18 */
	};
};
