## Kconfig
```kconfig
# Copyright (c) 2024 Silicon Laboratories Inc.
# SPDX-License-Identifier: Apache-2.0
#
# This Kconfig file is picked by the Zephyr build system because it is defined
# as the module Kconfig entry point (see zephyr/module.yml). You can browse
# module options by going to Zephyr -> Modules in Kconfig.

rsource "drivers/Kconfig"
rsource "soc/Kconfig"
```

## boards/silabs/radio_boards/siwx917_rb4338a/Kconfig.defconfig
```kconfig
# Copyright (c) 2023 Antmicro
# SPDX-License-Identifier: Apache-2.0

if BOARD_SIWX917_RB4338A

config BOARD
	default "siwx917_rb4338a"

endif
```

## boards/silabs/radio_boards/siwx917_rb4338a/siwx917_rb4338a_defconfig
```kconfig
# Copyright (c) 2023 Antmicro
# SPDX-License-Identifier: Apache-2.0

CONFIG_SYS_CLOCK_HW_CYCLES_PER_SEC=180000000
CONFIG_CONSOLE=y
CONFIG_UART_CONSOLE=y
CONFIG_SERIAL=y
CONFIG_PINCTRL=y
CONFIG_CLOCK_CONTROL=y
CONFIG_SIWX917_FLASH_MODE_COMMON=y
CONFIG_USE_DT_CODE_PARTITION=y
```

## drivers/Kconfig
```kconfig
# Copyright (c) 2025 Silicon Laboratories Inc.
# SPDX-License-Identifier: Apache-2.0

menu "Drivers"
rsource "entropy/Kconfig"
endmenu
```

## drivers/bluetooth/Kconfig
```kconfig
# Copyright (c) 2024 Silicon Laboratories Inc.
# SPDX-License-Identifier: Apache-2.0

if BT_HCI

rsource "hci/Kconfig.siwx917"

endif
```

## drivers/bluetooth/hci/Kconfig.siwx917
```kconfig
# Copyright (c) 2024 Silicon Laboratories Inc.
# SPDX-License-Identifier: Apache-2.0

config BT_SIWX917
	bool "Silabs SiWx917 Bluetooth interface"
	default y
	depends on DT_HAS_SILABS_BT_HCI_SIWX917_ENABLED
	select WISECONNECT_NETWORK_STACK
	select ENTROPY_GENERATOR
	help
	  Use Silicon Labs Wiseconnect 3.x Bluetooth library to connect to the controller.

# SiWx917 BLE controller currently does not support HCI Command: Host Number of Completed Packets
configdefault BT_HCI_ACL_FLOW_CONTROL
	default n if BT_SIWX917
```

## drivers/clock_control/Kconfig.siwx917
```kconfig
# Copyright (c) 2024 Silicon Laboratories Inc.
# SPDX-License-Identifier: Apache-2.0

config CLOCK_CONTROL_SILABS_SIWX917
	bool "SiWx917 clock control driver"
	default y
	depends on DT_HAS_SILABS_SIWX917_CLOCK_ENABLED
	help
	 Enable clock management on Silicon Labs SiWx917 chips. This driver
	 includes support for HP (High Performace), ULP (Ultra Low Power), and
	 ULP VBAT clocks.

	 The original hardware allow to customize the various clocks offered for
	 every devices. This driver does not provide such  customizations. It
	 just hardcodes sane default parameters for every devices.
```

## drivers/dma/Kconfig
```kconfig
# Copyright (c) 2024 Silicon Laboratories Inc.
# SPDX-License-Identifier: Apache-2.0

if DMA

rsource "Kconfig.siwx917"

endif
```

## drivers/dma/Kconfig.siwx917
```kconfig
# Copyright (c) 2024 Silicon Laboratories Inc.
# SPDX-License-Identifier: Apache-2.0

config DMA_SILABS_SIWX917
	bool "Silabs SiWx917 DMA driver"
	default y
	select SYS_MEM_BLOCKS
	depends on DT_HAS_SILABS_SIWX917_DMA_ENABLED
	help
	  Enable the High Power(HP)/Ultra Low Power(ULP) DMA driver for the Silabs SiWx917 SoC series.

config DMA_SILABS_SIWX917_SG_BUFFER_COUNT
	int "The maximum allowable number of buffers for scatter-gather transfers"
	default 10
```

## drivers/entropy/Kconfig.siwx917
```kconfig
# Copyright (c) 2024 Silicon Laboratories Inc.
# SPDX-License-Identifier: Apache-2.0

config ENTROPY_SILABS_SIWX917
	bool "SiWx917 RNG driver"
	default y
	depends on DT_HAS_SILABS_SIWX917_RNG_ENABLED
	select ENTROPY_HAS_DRIVER
	help
	 Enable hardware Random Number Generator embedded on Silicon Labs
	 SiWx917 chips.
```

## drivers/flash/Kconfig.siwx917
```kconfig
# Copyright (c) 2024 Silicon Laboratories Inc.
# SPDX-License-Identifier: Apache-2.0

config SOC_FLASH_SILABS_SIWX917
	bool "Silicon Labs SiWx917 flash driver"
	default y
	depends on DT_HAS_SILABS_SIWX917_FLASH_CONTROLLER_ENABLED
	depends on SIWX917_FLASH_MODE_COMMON
	select FLASH_HAS_DRIVER_ENABLED
	select FLASH_HAS_EXPLICIT_ERASE
	select FLASH_HAS_PAGE_LAYOUT
	# Flash controller is handled by the network coprocessor
	select WISECONNECT_NETWORK_STACK
	help
	  Enable flash controller for flash embedded on Silicon Labs SiWx917
	  chips.
```

## drivers/gpio/Kconfig
```kconfig
# Copyright (c) 2024 Silicon Laboratories Inc.
# SPDX-License-Identifier: Apache-2.0

if GPIO

rsource "Kconfig.siwx917"

endif
```

## drivers/gpio/Kconfig.siwx917
```kconfig
# Copyright (c) 2024 Silicon Laboratories Inc.
# SPDX-License-Identifier: Apache-2.0

menuconfig GPIO_SILABS_SIWX917
	bool "Silabs SiWx917 GPIO driver"
	default y
	depends on DT_HAS_SILABS_SIWX917_GPIO_ENABLED
	help
	  Enable the HP/ULP GPIO driver for the Silabs SiWx917 SoC series.

config GPIO_SILABS_SIWX917_COMMON_INIT_PRIORITY
	int "Common initialization priority"
	depends on GPIO_SILABS_SIWX917
	default 39

config GPIO_SILABS_SIWX917_UULP
	bool "Silabs SiWx917 UULP GPIO driver"
	default y
	depends on DT_HAS_SILABS_SIWX917_GPIO_UULP_ENABLED
	help
	  Enable the UULP GPIO driver for the Silabs SiWx917 SoC series.
```

## drivers/pinctrl/Kconfig
```kconfig
# Copyright (c) 2024 Silicon Laboratories Inc.
# SPDX-License-Identifier: Apache-2.0

if PINCTRL

rsource "Kconfig.siwx917"

endif
```

## drivers/pinctrl/Kconfig.siwx917
```kconfig
# Copyright (c) 2023 Antmicro
# SPDX-License-Identifier: Apache-2.0

config PINCTRL_SILABS_SIWX917
	bool "Silabs SiWx917 SoC series pinctrl driver"
	default y
	depends on DT_HAS_SILABS_SIWX917_PINCTRL_ENABLED
	help
	  Enable the pinctrl driver for the Silabs SiWx917 SoC series.
```

## drivers/watchdog/Kconfig.siwx917
```kconfig
# Copyright (c) 2025 Silicon Laboratories Inc.
# SPDX-License-Identifier: Apache-2.0

config WATCHDOG_SILABS_SIWX917
	bool "Silabs SiWx917 Watchdog driver"
	default y
	depends on DT_HAS_SILABS_SIWX917_WATCHDOG_ENABLED
	help
	  Enable the Watchdog driver for the Silabs SiWx917 SoC series.
```

## drivers/wifi/Kconfig
```kconfig
# Copyright (c) 2024 Silicon Laboratories Inc.
# SPDX-License-Identifier: Apache-2.0

if WIFI

rsource "siwx917/Kconfig.siwx917"

endif
```

## drivers/wifi/siwx917/Kconfig.siwx917
```kconfig
# Copyright (c) 2023 Antmicro
# SPDX-License-Identifier: Apache-2.0

config WIFI_SIWX917
	bool "Silabs SiWx917 SoC series WiFi driver"
	default y
	depends on DT_HAS_SILABS_SIWX917_WIFI_ENABLED
	select WISECONNECT_NETWORK_STACK
	select EVENTS
	select NET_L2_WIFI_MGMT
	help
	  Enable WiFi driver for the Silabs SiWx917 SoC series.

if WIFI_SIWX917

choice
	prompt "Network stack"
	default WIFI_SIWX917_NET_STACK_NATIVE
	help
	  Choose "Native" stack if you want a better compatibility with Zephyr
	  features. "Offloaded" stack may provide better resource (power and
	  memory) consumption.

config WIFI_SIWX917_NET_STACK_NATIVE
	bool "Native"
	select WIFI_USE_NATIVE_NETWORKING
	select NET_L2_ETHERNET

config WIFI_SIWX917_NET_STACK_OFFLOAD
	bool "Offloaded"
	select WIFI_OFFLOAD

endchoice

config NET_TCP_WORKQ_STACK_SIZE
	default 2048

config NET_RX_STACK_SIZE
	default 2048

config NET_MGMT_EVENT_STACK_SIZE
	default 2048

config NET_MGMT_EVENT_QUEUE_SIZE
	default 10

# Override the WIFI_MGMT_SCAN_SSID_FILT_MAX parameter for the Wi-Fi subsystem.
# This device supports filtering scan results for only one SSID.
config WIFI_MGMT_SCAN_SSID_FILT_MAX
	default 1

endif
```

## dts/bindings/bluetooth/silabs,bt-hci-siwx917.yaml
```yaml
description: Bluetooth HCI on Silabs boards

compatible: "silabs,bt-hci-siwx917"

include: bt-hci.yaml

properties:
  bt-hci-name:
    default: "sl:bt:siwx917"
  bt-hci-bus:
    default: "virtual"
  bt-hci-quirks:
    default: ["no-reset"]
```

## dts/bindings/clock/silabs,siwx917-clock.yaml
```yaml
# Copyright (c) 2024 Silicon Laboratories Inc.
# SPDX-License-Identifier: Apache-2.0

description: Clocks embedded on Silabs SiWx917 chips

compatible: "silabs,siwx917-clock"

include: [clock-controller.yaml, base.yaml]

properties:
  reg:
    required: true

  "#clock-cells":
    const: 1

clock-cells:
  - clkid
```

## dts/bindings/flash/silabs,siwx917-flash-controller.yaml
```yaml
# Copyright (c) 2024 Silicon Laboratories Inc.
# SPDX-License-Identifier: Apache-2.0

description: Silicon Labs SiWx917 flash controller

compatible: "silabs,siwx917-flash-controller"

include: flash-controller.yaml
```

## dts/bindings/gpio/silabs,siwx917-gpio-uulp.yaml
```yaml
description: Silabs SiWx917 UULP (ultra ultra low power) GPIO port node

compatible: "silabs,siwx917-gpio-uulp"

include: [gpio-controller.yaml, base.yaml]

properties:

  reg:
    required: true

  "#gpio-cells":
    const: 2

gpio-cells:
  - pin
  - flags
```

## dts/bindings/gpio/silabs,siwx917-gpio.yaml
```yaml
description: Silabs SiWx917 GPIO node

compatible: "silabs,siwx917-gpio"

include: base.yaml

properties:
  reg:
    required: true

  interrupts:
    required: true

  silabs,ulp:
    type: boolean
    description: |
      If this property is set, the GPIO controller uses ULP (ultra low power) pads.
```
