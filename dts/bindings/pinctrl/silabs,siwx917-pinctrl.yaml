## dts/bindings/pinctrl/silabs,siwx917-pinctrl.yaml
```yaml
# Copyright (c) 2023 Antmicro
# SPDX-License-Identifier: Apache-2.0

description: |
  The Silabs SiWx917 pin controller is a devicetree node tasked with selecting
  the proper IO function for a given pin.

  Create this node in the SoC devicetree as follows:

    pinctrl0: pinctrl {
      compatible = "silabs,siwx917-pinctrl";
    };

  This node expects a vector of three values:
    - Base number: 0 is high power, 1 is low power
    - Port number
    - Pin number
    - Mux (IO function)
    - Pad selection

  Create a configuration by referencing the 'pinctrl' node:

    &pinctrl0 {
      group1: group1 {
        pinmux = <0 0 29 2 0>;
      };
    };

compatible: "silabs,siwx917-pinctrl"

include: base.yaml

child-binding:
  description: |
    This binding gives a base representation of the Silabs SiWx917 pins
    configuration.

  properties:
    pinmux:
      required: true
      type: array
      description: |
        Silabs SiWx917 pin configuration (base, port, pin, mux, pad).
```

## dts/bindings/rng/silabs,siwx917-rng.yaml
```yaml
# Copyright (c) 2024 Silicon Laboratories Inc.
# SPDX-License-Identifier: Apache-2.0

description: Hardware Random Number Generator embedded on Silabs SiWx917 chips

compatible: "silabs,siwx917-rng"

include: base.yaml

properties:
  reg:
    required: true
```

## dts/bindings/watchdog/silabs,siwx917-watchdog.yaml
```yaml
description: Silabs SiWx917 Watchdog node

compatible: "silabs,siwx917-watchdog"

include: base.yaml

properties:
  reg:
    required: true

  interrupts:
    required: true
```

## dts/bindings/wifi/silabs,siwx917-wifi.yaml
```yaml
# Copyright (c) 2023 Antmicro
# SPDX-License-Identifier: Apache-2.0

description: Silabs SiWx917 SoC WiFi

compatible: "silabs,siwx917-wifi"
```

## soc/silabs/silabs_s2/Kconfig
```kconfig
# Copyright (c) 2025 Silicon Laboratories Inc.
# SPDX-License-Identifier: Apache-2.0

if SOC_FAMILY_SILABS_S2
if SECURE_STORAGE

config SECURE_STORAGE_ITS_TRANSFORM_AEAD_KEY_PROVIDER_SILABS
	bool "Secure Storage ITS transform AEAD key provider using Silicon Labs SE builtin key"
	default y
	depends on $(dt_has_compat,$(DT_COMPAT_SILABS_GECKO_SEMAILBOX))
	select MBEDTLS_PSA_CRYPTO_BUILTIN_KEYS
	select PSA_WANT_KEY_TYPE_AES
	select PSA_WANT_ALG_CMAC
	imply HWINFO

endif

endif
```

## soc/silabs/silabs_s2/Kconfig.sysbuild
```kconfig
# Copyright (c) 2025 Silicon Laboratories Inc.
# SPDX-License-Identifier: Apache-2.0

if BOOTLOADER_MCUBOOT

choice BOOT_SIGNATURE_TYPE
	default BOOT_SIGNATURE_TYPE_ECDSA_P256
endchoice

endif
```

## soc/silabs/silabs_siwx917/Kconfig.soc
```kconfig
# Copyright (c) 2023 Antmicro
# SPDX-License-Identifier: Apache-2.0
rsource "*/Kconfig.soc"

config SOC_FAMILY_SILABS_SIWX917
	bool
```

## soc/silabs/silabs_siwx917/siwg917/Kconfig
```kconfig
# Copyright (c) 2024 Silicon Laboratories Inc.
# SPDX-License-Identifier: Apache-2.0

config SOC_SERIES_SIWG917
	select SOC_FAMILY_SILABS_SIWX917

choice SIWX917_FLASH_MODE
	bool "Flash Mode"
	default SIWX917_FLASH_MODE_COMMON

config SIWX917_FLASH_MODE_COMMON
	bool "Common Flash"

config SIWX917_FLASH_MODE_DUAL
	bool "Dual Flash"

endchoice

config WISECONNECT_NETWORK_STACK
	bool
	select CMSIS_RTOS_V2
	select POLL
	select DYNAMIC_THREAD
	select THREAD_NAME
	select THREAD_STACK_INFO
	select THREAD_MONITOR
	select INIT_STACKS

if WISECONNECT_NETWORK_STACK

# WiseConnect create threads with realtime priority. Default (10kHz) clock tick
# prevent proper use of the system with these threads.
config SYS_CLOCK_TICKS_PER_SEC
	default 1024

config NUM_PREEMPT_PRIORITIES
	default 56

config CMSIS_V2_THREAD_DYNAMIC_MAX_COUNT
	default 2

config CMSIS_V2_THREAD_DYNAMIC_STACK_SIZE
	default 1024

config CMSIS_V2_THREAD_MAX_STACK_SIZE
	default 2048

endif #WISECONNECT_NETWORK_STACK
```

## soc/silabs/silabs_siwx917/siwg917/Kconfig.defconfig
```kconfig
# Copyright (c) 2023 Antmicro
# SPDX-License-Identifier: Apache-2.0

if SOC_SERIES_SIWG917

config NUM_IRQS
	default 99

config BUILD_OUTPUT_HEX
	default y

endif
```

## tests/crypto/psa_crypto/testcase.yaml
```yaml
# SPDX-License-Identifier: Apache-2.0
# Copyright (c) 2025 Silicon Laboratories Inc.
common:
  tags:
    - crypto
    - psa_crypto
    - drivers
tests:
  crypto.psa_crypto.default:
    platform_allow:
      - xg24_dk2601b
      - xg24_rb4187c
      - xg27_dk2602a
      - xg29_rb4412a
      - siwx917_rb4338a
    extra_configs:
      # on devices without hw accel, a bigger stack is needed for mpi math
      - CONFIG_TEST_EXTRA_STACK_SIZE=512
      - CONFIG_MBEDTLS_PSA_STATIC_KEY_SLOTS=n
  crypto.psa_crypto.sw_only:
    platform_allow:
      - xg24_dk2601b
      - xg24_rb4187c
      - xg27_dk2602a
      - xg29_rb4412a
      - siwx917_rb4338a
    extra_configs:
      - CONFIG_PSA_CRYPTO_SW_ONLY=y
      - CONFIG_MBEDTLS_PSA_P256M_DRIVER_ENABLED=y
      # a bigger stack is needed for mpi math
      - CONFIG_TEST_EXTRA_STACK_SIZE=512
```
